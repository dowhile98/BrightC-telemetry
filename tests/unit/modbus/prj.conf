## CMakeLists.txt
```
# SPDX-License-Identifier: Apache-2.0
cmake_minimum_required(VERSION 3.20.0)
find_package(Zephyr REQUIRED HINTS $ENV{ZEPHYR_BASE})
project(unit_modbus_test)

set(APP_DIR ${CMAKE_CURRENT_SOURCE_DIR}/../../..)

target_sources(app PRIVATE
    src/test_modbus_types.c
    src/test_interfaces.c
    src/test_cwt_tm16pt.c
    src/test_jsy_mk339_codec.c
    src/test_slave_scheduler.c
    src/test_modbus_registry.c
    src/test_composition_root.c
    src/test_mbsl32di_codec.c
    src/test_waveshare_relay_codec.c
    src/test_adapter_relay_modbus.c
    ${APP_DIR}/tests/fakes/src/fake_energy_meter.c
    ${APP_DIR}/tests/fakes/src/fake_network.c
    ${APP_DIR}/tests/fakes/src/fake_config_storage.c
    ${APP_DIR}/tests/fakes/src/fake_rtc.c
    ${APP_DIR}/tests/mocks/fake_storage_fs.c
    ${APP_DIR}/tests/mocks/fake_bkpsram.c
    ${APP_DIR}/tests/fakes/src/fake_led.c
    ${APP_DIR}/tests/fakes/src/fake_buzzer.c
    ${APP_DIR}/tests/fakes/src/fake_digital_input.c
    ${APP_DIR}/app/src/domain/services/cwt_tm16pt_codec.c
    ${APP_DIR}/app/src/domain/services/jsy_mk339_codec.c
    ${APP_DIR}/app/src/domain/services/mbsl32di_codec.c
    ${APP_DIR}/app/src/domain/services/waveshare_relay_codec.c
    ${APP_DIR}/app/src/domain/services/sensor_matrix_mapper.c
    ${APP_DIR}/app/src/domain/services/slave_scheduler.c
    ${APP_DIR}/app/src/domain/time/rtc_time_calc.c
    ${APP_DIR}/app/src/domain/storage/sd_lifecycle_sm.c
    ${APP_DIR}/app/src/domain/services/digital_input_aggregator.c
    ${APP_DIR}/app/src/application/modbus/modbus_registry.c
    ${APP_DIR}/app/src/application/modbus/modbus_device_table.c
    ${APP_DIR}/app/src/application/active_objects/ao_modbus.c
    ${APP_DIR}/app/src/application/active_objects/ao_network.c
    ${APP_DIR}/app/src/application/active_objects/ao_storage.c
    ${APP_DIR}/app/src/application/active_objects/ao_storage_sd.c
    ${APP_DIR}/app/src/application/active_objects/ao_datalogger.c
    ${APP_DIR}/app/src/domain/storage/bkpsram_ring.c
    ${APP_DIR}/app/src/application/active_objects/ao_system_indicator.c
    ${APP_DIR}/app/src/application/active_objects/ao_digital_input.c
    ${APP_DIR}/app/src/application/active_objects/ao_sensor_matrix.c
    ${APP_DIR}/app/src/application/zbus/network_channels.c
    ${APP_DIR}/app/src/application/zbus/config_channels.c
    ${APP_DIR}/app/src/application/zbus/storage_channels.c
    ${APP_DIR}/app/src/application/zbus/system_channels.c
    ${APP_DIR}/app/src/application/zbus/indicator_channels.c
    ${APP_DIR}/app/src/application/zbus/digital_input_channels.c
    ${APP_DIR}/app/src/infrastructure/adapters/adapter_relay_modbus.c
    ${APP_DIR}/app/src/infrastructure/adapters/adapter_relay_gpio.c
    ${APP_DIR}/app/src/infrastructure/adapters/adapter_hvac_actuator.c
    ${APP_DIR}/app/src/application/active_objects/ao_hvac.c
    ${APP_DIR}/app/src/application/zbus/hvac_channels.c
    ${APP_DIR}/app/src/application/zbus/sensor_channels.c
    ${APP_DIR}/app/src/domain/models/hvac_unit_entity.c
    ${APP_DIR}/app/src/domain/models/hvac_group_entity.c
    ${APP_DIR}/app/src/infrastructure/di/composition_root.c
    ${APP_DIR}/app/src/application/services/app_facade.c
    ${APP_DIR}/tests/fakes/src/fake_sensor_matrix.c
    ${APP_DIR}/app/src/domain/alarm/alarm_entity.c
    ${APP_DIR}/app/src/domain/alarm/alarm_aggregate.c
    ${APP_DIR}/app/src/domain/alarm/alarm_evaluator.c
    ${APP_DIR}/app/src/domain/alarm/alarm_registry.c
    ${APP_DIR}/app/src/infrastructure/adapters/adapter_alarm_detector_di.c
    ${APP_DIR}/app/src/infrastructure/adapters/adapter_alarm_detector_temp.c
    ${APP_DIR}/app/src/infrastructure/adapters/adapter_alarm_detector_volt.c
    ${APP_DIR}/app/src/infrastructure/adapters/adapter_alarm_detector_hvac.c
    ${APP_DIR}/app/src/application/active_objects/ao_alarm_manager.c
    ${APP_DIR}/app/src/application/zbus/alarm_channels.c
    ${APP_DIR}/app/src/application/active_objects/ao_thermal_energy.c
    ${APP_DIR}/app/src/application/zbus/thermal_channels.c
    ${APP_DIR}/app/src/infrastructure/adapters/sensor_matrix_mapper.c
    ${APP_DIR}/app/src/domain/thermal_energy/humidity_transducer.c
    ${APP_DIR}/app/src/domain/thermal_energy/psychrometrics.c
    ${APP_DIR}/app/src/domain/thermal_energy/thermodynamics.c
    ${APP_DIR}/app/src/domain/thermal_energy/compressor_fsm.c
    ${APP_DIR}/app/src/domain/thermal_energy/predictive_analytics.c
)

target_include_directories(app PRIVATE
    ${APP_DIR}/app/include
    ${APP_DIR}/app/src
    ${APP_DIR}/app/src/domain/services
    ${APP_DIR}/app/src/application/modbus
    ${APP_DIR}/lib
    ${APP_DIR}/lib/codec_modbus
    ${APP_DIR}/lib/transducers
    ${APP_DIR}/tests/fakes/include
    ${APP_DIR}/tests/mocks
)
```

## Kconfig
```
# SPDX-License-Identifier: Apache-2.0

mainmenu "Unit Modbus Test"

source "Kconfig.zephyr"

config APP_MODBUS_INTER_POLL_DELAY_MS
	int "Inter-poll turnaround delay in milliseconds"
	default 10
	range 0 1000
	help
	  Turnaround delay between consecutive Modbus transactions on the same
	  RS-485 bus. Gives slave transceivers time to release the bus and
	  satisfies the Modbus RTU inter-frame silence interval (t3.5+).

# Compile the unit tests against the production Modbus topology so the test
# build and the firmware build cannot disagree about slaves, buses or addresses.
rsource "../../../app/Kconfig.modbus"
```

## prj.conf
```kconfig
# SPDX-License-Identifier: Apache-2.0
CONFIG_ZTEST=y
CONFIG_ASSERT=y
CONFIG_APP_MODBUS_INTER_POLL_DELAY_MS=10
CONFIG_ZBUS=y
```

## src/main.c
```c
/*
 * Copyright (c) 2026 DAECGE
 * SPDX-License-Identifier: Apache-2.0
 *
 * TDD Unit Tests for CWT-TM-16PT Temperature Driver and Modbus Slave Manager.
 */

#include <zephyr/ztest.h>
#include <string.h>
#include "cwt_tm16pt.h"
#include "modbus_slave_manager.h"
#include "common/modbus_slave_config.h"

/* =========================================================================
 * 1. CWT-TM-16PT Sensor Driver Tests
 * ========================================================================= */
ZTEST_SUITE(cwt_tm16pt_suite, NULL, NULL, NULL, NULL, NULL);

ZTEST(cwt_tm16pt_suite, test_cwt_tm16pt_parse_scaled_normal)
{
    uint16_t simulated_regs[16];
    /* Channel 0: 254 = 25.4 C
     * Channel 1: 300 = 30.0 C
     * Channel 2: -150 = -15.0 C (int16 0xFF6A)
     * Channels 3-15: 200 = 20.0 C */
    simulated_regs[0] = 254;
    simulated_regs[1] = 300;
    simulated_regs[2] = (uint16_t)(-150);
    for (int i = 3; i < 16; i++) {
        simulated_regs[i] = 200;
    }

    temperature_bank_16ch_t bank;
    memset(&bank, 0, sizeof(bank));

    int err = cwt_tm16pt_parse_scaled_temperatures(simulated_regs, 16, &bank);
    zassert_equal(err, 0, "Parser returned error");
    zassert_true(bank.is_communication_valid, "Communication should be valid");
    zassert_equal(bank.open_probe_mask, 0, "No open probes expected");
    zassert_equal(bank.valid_channels_mask, 0xFFFF, "All 16 channels must be valid");

    zassert_within(bank.temperatures_c[0], 25.4f, 0.01f, "Ch0 mismatch");
    zassert_within(bank.temperatures_c[1], 30.0f, 0.01f, "Ch1 mismatch");
    zassert_within(bank.temperatures_c[2], -15.0f, 0.01f, "Ch2 negative temp mismatch");
    zassert_within(bank.temperatures_c[15], 20.0f, 0.01f, "Ch15 mismatch");
}

ZTEST(cwt_tm16pt_suite, test_cwt_tm16pt_parse_scaled_open_probe_detection)
{
    uint16_t simulated_regs[16];
    for (int i = 0; i < 16; i++) {
        simulated_regs[i] = 220; /* 22.0 C */
    }

    /* Channel 3: Disconnected probe (0x7FFF = 32767) */
    simulated_regs[3] = CWT_TM16PT_PROBE_OPEN_CODE;
    /* Channel 7: Broken probe sentinel (-32768) */
    simulated_regs[7] = 0x8000;

    temperature_bank_16ch_t bank;
    memset(&bank, 0, sizeof(bank));

    int err = cwt_tm16pt_parse_scaled_temperatures(simulated_regs, 16, &bank);
    zassert_equal(err, 0, "Parser returned error");

    /* Channel 3 and Channel 7 must be in open probe mask */
    uint16_t expected_open = (1U << 3) | (1U << 7);
    zassert_equal(bank.open_probe_mask, expected_open, "Open probe mask mismatch");

    /* Valid mask must NOT have bit 3 and 7 */
    zassert_false((bank.valid_channels_mask & (1U << 3)), "Ch3 must not be valid");
    zassert_false((bank.valid_channels_mask & (1U << 7)), "Ch7 must not be valid");
    zassert_true((bank.valid_channels_mask & (1U << 0)), "Ch0 must be valid");
}

ZTEST(cwt_tm16pt_suite, test_cwt_tm16pt_config_register_build_and_parse)
{
    uint16_t reg_val = 0;

    /* Build config: Slave ID 1, 9600 bps, None Parity (0) */
    int err = cwt_tm16pt_build_config_register(1, 9600, 0, &reg_val);
    zassert_equal(err, 0, "Build failed for default 9600 8N1");
    zassert_equal(reg_val, 0x0100, "Expected 0x0100 for ID 1, 9600, None");

    uint8_t out_id = 0, out_parity = 0;
    uint32_t out_baud = 0;
    err = cwt_tm16pt_parse_config_register(reg_val, &out_id, &out_baud, &out_parity);
    zassert_equal(err, 0, "Parse failed");
    zassert_equal(out_id, 1, "Slave ID mismatch");
    zassert_equal(out_baud, 9600, "Baudrate mismatch");
    zassert_equal(out_parity, 0, "Parity mismatch");

    /* Build config: Slave ID 10, 19200 bps (code 6), Even Parity (code 1) */
    /* low byte: 6 | (1 << 3) = 6 | 8 = 14 = 0x0E. High byte: 10 = 0x0A -> 0x0A0E */
    err = cwt_tm16pt_build_config_register(10, 19200, 1, &reg_val);
    zassert_equal(err, 0, "Build failed for 19200 Even");
    zassert_equal(reg_val, 0x0A0E, "Expected 0x0A0E for ID 10, 19200, Even");

    err = cwt_tm16pt_parse_config_register(reg_val, &out_id, &out_baud, &out_parity);
    zassert_equal(err, 0, "Parse failed");
    zassert_equal(out_id, 10, "Slave ID mismatch");
    zassert_equal(out_baud, 19200, "Baudrate mismatch");
    zassert_equal(out_parity, 1, "Parity mismatch");
}

/* =========================================================================
 * 2. Modbus Slave Manager & Failover Tests
 * ========================================================================= */
ZTEST_SUITE(modbus_slave_manager_suite, NULL, NULL, NULL, NULL, NULL);

ZTEST(modbus_slave_manager_suite, test_manager_init_and_failover_bus_change)
{
    /* 1. Init manager: registers Device ID 1 (CWT-TM-16PT) on RS485-1 */
    int err = modbus_slave_manager_init();
    zassert_equal(err, 0, "Init failed");

    modbus_slave_descriptor_t desc;
    err = modbus_slave_manager_get(1, &desc);
    zassert_equal(err, 0, "Device 1 not found");
    zassert_equal(desc.bus_id, MODBUS_BUS_RS485_1, "Default bus should be RS485-1");
    zassert_equal(desc.slave_addr, 1, "Default addr should be 1");
    zassert_equal(desc.dev_type, MODBUS_DEV_TYPE_CWT_TM16PT, "Dev type mismatch");

    /* Query bus 1 devices */
    uint8_t dev_ids[4];
    size_t count = 0;
    err = modbus_slave_manager_get_bus_devices(MODBUS_BUS_RS485_1, dev_ids, 4, &count);
    zassert_equal(err, 0, "Bus 1 query failed");
    zassert_equal(count, 1, "Expected 1 device on Bus 1");
    zassert_equal(dev_ids[0], 1, "Expected Device ID 1");

    /* 2. DYNAMIC FAILOVER: Transceiver 1 damaged! Move Device 1 to RS485-2 */
    err = modbus_slave_manager_set_bus(1, MODBUS_BUS_RS485_2);
    zassert_equal(err, 0, "Set bus failed");

    /* Verify device 1 is NO LONGER on Bus 1 */
    count = 0;
    modbus_slave_manager_get_bus_devices(MODBUS_BUS_RS485_1, dev_ids, 4, &count);
    zassert_equal(count, 0, "Bus 1 should have 0 devices now");

    /* Verify device 1 is NOW active on Bus 2 */
    count = 0;
    modbus_slave_manager_get_bus_devices(MODBUS_BUS_RS485_2, dev_ids, 4, &count);
    zassert_equal(count, 1, "Bus 2 should have 1 device");
    zassert_equal(dev_ids[0], 1, "Device 1 should be on Bus 2");
}

ZTEST(modbus_slave_manager_suite, test_manager_offline_backoff_state_machine)
{
    modbus_slave_manager_init();

    modbus_slave_runtime_state_t st;
    modbus_slave_manager_get_runtime_state(1, &st);
    zassert_equal(st.health, MODBUS_HEALTH_ONLINE, "Initial health should be ONLINE");

    /* Fail 1: should become DEGRADED */
    modbus_slave_manager_record_result(1, false, 1000);
    modbus_slave_manager_get_runtime_state(1, &st);
    zassert_equal(st.health, MODBUS_HEALTH_DEGRADED, "Health should be DEGRADED after 1 fail");

    /* Fail 2: still DEGRADED */
    modbus_slave_manager_record_result(1, false, 2000);
    modbus_slave_manager_get_runtime_state(1, &st);
    zassert_equal(st.health, MODBUS_HEALTH_DEGRADED, "Health should still be DEGRADED");

    /* Fail 3: triggers OFFLINE BACKOFF threshold! */
    modbus_slave_manager_record_result(1, false, 3000);
    modbus_slave_manager_get_runtime_state(1, &st);
    zassert_equal(st.health, MODBUS_HEALTH_OFFLINE_BACKOFF, "Health must transition to OFFLINE BACKOFF");

    /* Verify Backoff Polling behavior:
     * Last poll was at 3000 ms.
     * At 4500 ms (elapsed 1500 ms): normal 1000ms poll interval would trigger,
     * but because of backoff (10000ms threshold), it MUST NOT be ready! */
    bool ready = modbus_slave_manager_is_ready_to_poll(1, 4500);
    zassert_false(ready, "Device in offline backoff must NOT poll at normal rate!");

    /* At 13500 ms (elapsed 10500 ms >= 10000 ms): Probe ping should trigger */
    ready = modbus_slave_manager_is_ready_to_poll(1, 13500);
    zassert_true(ready, "Probe ping should trigger after backoff interval");

    /* Success: device responds again! Immediate recovery to ONLINE */
    modbus_slave_manager_record_result(1, true, 13550);
    modbus_slave_manager_get_runtime_state(1, &st);
    zassert_equal(st.health, MODBUS_HEALTH_ONLINE, "Health must recover to ONLINE on success");
    zassert_equal(st.consecutive_fails, 0, "Consecutive fails must reset to 0");
}

ZTEST(modbus_slave_manager_suite, test_manager_export_import_serialization)
{
    modbus_slave_manager_init();

    /* Register a second device */
    modbus_slave_descriptor_t dev2 = {
        .device_id = 2,
        .bus_id = MODBUS_BUS_RS485_2,
        .slave_addr = 5,
        .dev_type = MODBUS_DEV_TYPE_ENERGY_METER_SDM,
        .poll_interval_ms = 500,
        .timeout_ms = 250,
        .is_enabled = true,
    };
    modbus_slave_manager_register(&dev2);

    /* Export to raw buffer (as microconf / EEPROM will do) */
    uint8_t buffer[256];
    size_t exported_size = 0;
    int err = modbus_slave_manager_export_config(buffer, sizeof(buffer), &exported_size);
    zassert_equal(err, 0, "Export failed");
    zassert_true(exported_size > 0, "Exported size must be > 0");

    /* Reset / re-import */
    err = modbus_slave_manager_import_config(buffer, exported_size);
    zassert_equal(err, 0, "Import failed");

    /* Verify device 1 and device 2 intact */
    modbus_slave_descriptor_t d1, d2;
    zassert_equal(modbus_slave_manager_get(1, &d1), 0, "Device 1 missing after import");
    zassert_equal(d1.slave_addr, 1, "D1 slave addr mismatch");

    zassert_equal(modbus_slave_manager_get(2, &d2), 0, "Device 2 missing after import");
    zassert_equal(d2.slave_addr, 5, "D2 slave addr mismatch");
    zassert_equal(d2.dev_type, MODBUS_DEV_TYPE_ENERGY_METER_SDM, "D2 dev type mismatch");
    zassert_equal(d2.bus_id, MODBUS_BUS_RS485_2, "D2 bus mismatch");
}
```

## src/test_adapter_relay_modbus.c
```c
/*
 * Copyright (c) 2026 DAECGE
 * SPDX-License-Identifier: Apache-2.0
 *
 * Unit tests for adapter_relay_modbus (Waveshare Modbus RTU 32CH relay adapter).
 */

#include <zephyr/ztest.h>
#include <errno.h>
#include <string.h>

#include "application/active_objects/ao_modbus.h"
#include "domain/services/waveshare_relay_codec.h"
#include "infrastructure/adapters/adapter_relay_modbus.h"
#include "interfaces/i_relay.h"

#define TEST_SLAVE_ADDR 4U
#define TEST_TIMEOUT_MS 300U

static struct k_msgq s_test_queue;
static modbus_event_t s_queue_buf[4];
static ao_modbus_t s_test_ao;
static adapter_relay_modbus_t s_adapter;
static i_relay_t s_relay;

static void setup_fixture(void *fixture)
{
    ARG_UNUSED(fixture);
    k_msgq_init(&s_test_queue, (char *) s_queue_buf, sizeof(modbus_event_t), 4);
    (void) memset(&s_test_ao, 0, sizeof(s_test_ao));
    s_test_ao.queue = &s_test_queue;

    (void) memset(&s_adapter, 0, sizeof(s_adapter));
    (void) memset(&s_relay, 0, sizeof(s_relay));
}

ZTEST_SUITE(adapter_relay_modbus_suite, NULL, NULL, setup_fixture, NULL, NULL);

ZTEST(adapter_relay_modbus_suite, test_init_and_port_binding)
{
    int err = adapter_relay_modbus_init(&s_adapter, &s_test_ao, TEST_SLAVE_ADDR, TEST_TIMEOUT_MS);
    zassert_equal(err, 0, "adapter_relay_modbus_init failed (%d)", err);

    err = adapter_relay_modbus_port(&s_adapter, &s_relay);
    zassert_equal(err, 0, "adapter_relay_modbus_port failed (%d)", err);
    zassert_true(i_relay_is_bound(&s_relay), "Port must be bound");

    /* Default states must be OPEN and status initialised */
    for (relay_channel_t ch = 0; ch < WAVESHARE_RELAY_32CH_CHANNEL_COUNT; ch++) {
        relay_state_t state = RELAY_STATE_CLOSED;
        err = i_relay_get_state(&s_relay, ch, &state);
        zassert_equal(err, 0, "get_state failed for channel %d", ch);
        zassert_equal(state, RELAY_STATE_OPEN, "Default state for channel %d must be OPEN", ch);

        relay_channel_status_t status;
        err = i_relay_get_status(&s_relay, ch, &status);
        zassert_equal(err, 0, "get_status failed for channel %d", ch);
        zassert_equal(status.state, RELAY_STATE_OPEN, "Default status state for channel %d must be OPEN", ch);
        zassert_equal(status.cycle_count, 0U, "Default cycle_count for channel %d must be 0", ch);
        zassert_equal(status.last_toggle_ms, 0U, "Default last_toggle_ms for channel %d must be 0", ch);
        zassert_false(status.is_fault, "Default is_fault for channel %d must be false", ch);
    }
}

ZTEST(adapter_relay_modbus_suite, test_init_rejects_invalid_arguments)
{
    zassert_equal(adapter_relay_modbus_init(NULL, &s_test_ao, TEST_SLAVE_ADDR, TEST_TIMEOUT_MS),
                  -EINVAL, "NULL self must be rejected");
    zassert_equal(adapter_relay_modbus_init(&s_adapter, NULL, TEST_SLAVE_ADDR, TEST_TIMEOUT_MS),
                  -EINVAL, "NULL ao must be rejected");
    zassert_equal(adapter_relay_modbus_init(&s_adapter, &s_test_ao, 0U, TEST_TIMEOUT_MS),
                  -EINVAL, "Zero slave_addr must be rejected");
    zassert_equal(adapter_relay_modbus_init(&s_adapter, &s_test_ao, TEST_SLAVE_ADDR, 0),
                  -EINVAL, "Zero timeout must be rejected");
    zassert_equal(adapter_relay_modbus_init(&s_adapter, &s_test_ao, TEST_SLAVE_ADDR, -1),
                  -EINVAL, "Negative timeout must be rejected");

    zassert_equal(adapter_relay_modbus_port(NULL, &s_relay), -EINVAL, "NULL self must be rejected");
    zassert_equal(adapter_relay_modbus_port(&s_adapter, NULL), -EINVAL, "NULL out must be rejected");
}

ZTEST(adapter_relay_modbus_suite, test_set_state_posts_event_and_updates_cache)
{
    int err = adapter_relay_modbus_init(&s_adapter, &s_test_ao, TEST_SLAVE_ADDR, TEST_TIMEOUT_MS);
    zassert_equal(err, 0, "Init failed");
    err = adapter_relay_modbus_port(&s_adapter, &s_relay);
    zassert_equal(err, 0, "Port failed");

    /* Set channel 5 to CLOSED */
    err = i_relay_set_state(&s_relay, (relay_channel_t) 5, RELAY_STATE_CLOSED);
    zassert_equal(err, 0, "set_state channel 5 CLOSED failed");

    /* Verify event in queue */
    modbus_event_t event;
    err = k_msgq_get(&s_test_queue, &event, K_NO_WAIT);
    zassert_equal(err, 0, "Event not found in queue");
    zassert_equal(event.type, AO_MODBUS_EVENT_WRITE_COIL, "Event type mismatch");
    zassert_equal(event.slave_addr, TEST_SLAVE_ADDR, "Slave address mismatch");
    zassert_equal(event.coil_addr, 5U, "Coil address mismatch");
    zassert_equal(event.coil_value, WAVESHARE_RELAY_COIL_ON, "Coil value mismatch (expected 0xFF00)");
    zassert_equal(event.timeout_ms, TEST_TIMEOUT_MS, "Timeout mismatch");

    /* Verify cache updated optimistically */
    relay_state_t state = RELAY_STATE_OPEN;
    err = i_relay_get_state(&s_relay, (relay_channel_t) 5, &state);
    zassert_equal(err, 0, "get_state failed");
    zassert_equal(state, RELAY_STATE_CLOSED, "Cache state must be CLOSED");

    /* Set channel 5 back to OPEN */
    err = i_relay_set_state(&s_relay, (relay_channel_t) 5, RELAY_STATE_OPEN);
    zassert_equal(err, 0, "set_state channel 5 OPEN failed");

    err = k_msgq_get(&s_test_queue, &event, K_NO_WAIT);
    zassert_equal(err, 0, "Event not found in queue");
    zassert_equal(event.coil_addr, 5U, "Coil address mismatch");
    zassert_equal(event.coil_value, WAVESHARE_RELAY_COIL_OFF, "Coil value mismatch (expected 0x0000)");

    err = i_relay_get_state(&s_relay, (relay_channel_t) 5, &state);
    zassert_equal(err, 0, "get_state failed");
    zassert_equal(state, RELAY_STATE_OPEN, "Cache state must be OPEN");
}

ZTEST(adapter_relay_modbus_suite, test_set_and_get_state_rejects_out_of_range_channels)
{
    int err = adapter_relay_modbus_init(&s_adapter, &s_test_ao, TEST_SLAVE_ADDR, TEST_TIMEOUT_MS);
    zassert_equal(err, 0, "Init failed");
    err = adapter_relay_modbus_port(&s_adapter, &s_relay);
    zassert_equal(err, 0, "Port failed");

    relay_state_t state;
    /* Out-of-range channel >= WAVESHARE_RELAY_32CH_CHANNEL_COUNT */
    zassert_equal(i_relay_set_state(&s_relay, (relay_channel_t) 32, RELAY_STATE_CLOSED),
                  -EINVAL, "Channel 32 must be rejected");
    zassert_equal(i_relay_get_state(&s_relay, (relay_channel_t) 32, &state),
                  -EINVAL, "Channel 32 get must be rejected");

    zassert_equal(i_relay_get_state(&s_relay, (relay_channel_t) 0, NULL),
                  -EINVAL, "NULL out_state must be rejected");

    /* Queue should still be empty */
    zassert_equal(k_msgq_num_used_get(&s_test_queue), 0, "Queue must remain empty on rejected calls");
}

ZTEST(adapter_relay_modbus_suite, test_queue_full_returns_enomsg)
{
    int err = adapter_relay_modbus_init(&s_adapter, &s_test_ao, TEST_SLAVE_ADDR, TEST_TIMEOUT_MS);
    zassert_equal(err, 0, "Init failed");
    err = adapter_relay_modbus_port(&s_adapter, &s_relay);
    zassert_equal(err, 0, "Port failed");

    /* Fill the queue (depth = 4) */
    for (int i = 0; i < 4; i++) {
        err = i_relay_set_state(&s_relay, (relay_channel_t) i, RELAY_STATE_CLOSED);
        zassert_equal(err, 0, "Queue fill %d failed", i);
    }

    /* 5th call must return -ENOMSG after retries */
    err = i_relay_set_state(&s_relay, (relay_channel_t) 4, RELAY_STATE_CLOSED);
    zassert_equal(err, -ENOMSG, "Full queue must yield -ENOMSG");

    /* Verify non-optimistic cache: channel 4 state must remain OPEN */
    relay_state_t cached_state = RELAY_STATE_CLOSED;
    err = i_relay_get_state(&s_relay, (relay_channel_t) 4, &cached_state);
    zassert_equal(err, 0, "Get state failed");
    zassert_equal(cached_state, RELAY_STATE_OPEN, "Cache must not be updated on queue full failure");
}

ZTEST(adapter_relay_modbus_suite, test_update_coils_synchronizes_cache)
{
    int err = adapter_relay_modbus_init(&s_adapter, &s_test_ao, TEST_SLAVE_ADDR, TEST_TIMEOUT_MS);
    zassert_equal(err, 0, "Init failed");
    err = adapter_relay_modbus_port(&s_adapter, &s_relay);
    zassert_equal(err, 0, "Port failed");

    relay_state_t new_states[WAVESHARE_RELAY_32CH_CHANNEL_COUNT];
    for (size_t i = 0; i < WAVESHARE_RELAY_32CH_CHANNEL_COUNT; i++) {
        new_states[i] = (i % 2 == 0) ? RELAY_STATE_CLOSED : RELAY_STATE_OPEN;
    }

    err = adapter_relay_modbus_update_coils(&s_adapter, new_states, WAVESHARE_RELAY_32CH_CHANNEL_COUNT);
    zassert_equal(err, 0, "update_coils failed");

    for (relay_channel_t ch = 0; ch < WAVESHARE_RELAY_32CH_CHANNEL_COUNT; ch++) {
        relay_state_t state;
        err = i_relay_get_state(&s_relay, ch, &state);
        zassert_equal(err, 0, "get_state failed");
        relay_state_t expected = (ch % 2 == 0) ? RELAY_STATE_CLOSED : RELAY_STATE_OPEN;
        zassert_equal(state, expected, "Channel %d state mismatch after update", ch);
    }

    /* Rejection of invalid arguments */
    zassert_equal(adapter_relay_modbus_update_coils(NULL, new_states, 32), -EINVAL, "NULL self");
    zassert_equal(adapter_relay_modbus_update_coils(&s_adapter, NULL, 32), -EINVAL, "NULL states");
    zassert_equal(adapter_relay_modbus_update_coils(&s_adapter, new_states, 0), -EINVAL, "Zero count");
    zassert_equal(adapter_relay_modbus_update_coils(&s_adapter, new_states, 33), -EINVAL, "Count > 32");
}

ZTEST(adapter_relay_modbus_suite, test_update_from_raw_parses_and_synchronizes)
{
    int err = adapter_relay_modbus_init(&s_adapter, &s_test_ao, TEST_SLAVE_ADDR, TEST_TIMEOUT_MS);
    zassert_equal(err, 0, "Init failed");
    err = adapter_relay_modbus_port(&s_adapter, &s_relay);
    zassert_equal(err, 0, "Port failed");

    /* Byte 0 = 0x05 (ch0 and ch2 CLOSED) */
    /* Byte 1 = 0x80 (ch15 CLOSED) */
    /* Byte 2 = 0x00 */
    /* Byte 3 = 0x01 (ch24 CLOSED) */
    uint8_t raw_bytes[WAVESHARE_RELAY_COIL_BYTES] = {0x05, 0x80, 0x00, 0x01};

    err = adapter_relay_modbus_update_from_raw(&s_adapter, raw_bytes, sizeof(raw_bytes));
    zassert_equal(err, 0, "update_from_raw failed");

    relay_state_t state;
    zassert_equal(i_relay_get_state(&s_relay, (relay_channel_t) 0, &state), 0, "get ch0");
    zassert_equal(state, RELAY_STATE_CLOSED, "ch0 must be CLOSED");

    zassert_equal(i_relay_get_state(&s_relay, (relay_channel_t) 1, &state), 0, "get ch1");
    zassert_equal(state, RELAY_STATE_OPEN, "ch1 must be OPEN");

    zassert_equal(i_relay_get_state(&s_relay, (relay_channel_t) 2, &state), 0, "get ch2");
    zassert_equal(state, RELAY_STATE_CLOSED, "ch2 must be CLOSED");

    zassert_equal(i_relay_get_state(&s_relay, (relay_channel_t) 15, &state), 0, "get ch15");
    zassert_equal(state, RELAY_STATE_CLOSED, "ch15 must be CLOSED");

    zassert_equal(i_relay_get_state(&s_relay, (relay_channel_t) 24, &state), 0, "get ch24");
    zassert_equal(state, RELAY_STATE_CLOSED, "ch24 must be CLOSED");

    /* Short buffer rejected */
    zassert_equal(adapter_relay_modbus_update_from_raw(&s_adapter, raw_bytes, 3U), -EINVAL, "Short buffer");
}

ZTEST(adapter_relay_modbus_suite, test_get_status_tracks_cycle_count_and_timing)
{
    int err = adapter_relay_modbus_init(&s_adapter, &s_test_ao, TEST_SLAVE_ADDR, TEST_TIMEOUT_MS);
    zassert_equal(err, 0, "Init failed");
    err = adapter_relay_modbus_port(&s_adapter, &s_relay);
    zassert_equal(err, 0, "Port failed");

    relay_channel_status_t status;

    /* First toggle */
    err = i_relay_set_state(&s_relay, (relay_channel_t) 7, RELAY_STATE_CLOSED);
    zassert_equal(err, 0, "set_state channel 7 CLOSED failed");

    err = i_relay_get_status(&s_relay, (relay_channel_t) 7, &status);
    zassert_equal(err, 0, "get_status failed");
    zassert_equal(status.state, RELAY_STATE_CLOSED, "State mismatch");
    zassert_equal(status.cycle_count, 1U, "Cycle count must be 1");
    zassert_false(status.is_fault, "is_fault must be false");

    /* Second toggle */
    err = i_relay_set_state(&s_relay, (relay_channel_t) 7, RELAY_STATE_OPEN);
    zassert_equal(err, 0, "set_state channel 7 OPEN failed");

    err = i_relay_get_status(&s_relay, (relay_channel_t) 7, &status);
    zassert_equal(err, 0, "get_status failed");
    zassert_equal(status.state, RELAY_STATE_OPEN, "State mismatch");
    zassert_equal(status.cycle_count, 2U, "Cycle count must be 2");
    zassert_false(status.is_fault, "is_fault must be false");

    /* Other channel remains unaffected */
    err = i_relay_get_status(&s_relay, (relay_channel_t) 8, &status);
    zassert_equal(err, 0, "get_status failed");
    zassert_equal(status.state, RELAY_STATE_OPEN, "Channel 8 must remain OPEN");
    zassert_equal(status.cycle_count, 0U, "Channel 8 cycle count must be 0");
}

ZTEST(adapter_relay_modbus_suite, test_get_status_rejects_invalid_arguments)
{
    int err = adapter_relay_modbus_init(&s_adapter, &s_test_ao, TEST_SLAVE_ADDR, TEST_TIMEOUT_MS);
    zassert_equal(err, 0, "Init failed");
    err = adapter_relay_modbus_port(&s_adapter, &s_relay);
    zassert_equal(err, 0, "Port failed");

    relay_channel_status_t status;

    /* Out of range channel */
    zassert_equal(i_relay_get_status(&s_relay, (relay_channel_t) 32, &status),
                  -EINVAL, "Channel 32 must be rejected");

    /* NULL output */
    zassert_equal(i_relay_get_status(&s_relay, (relay_channel_t) 0, NULL),
                  -EINVAL, "NULL out_status must be rejected");

    /* Unbound port */
    i_relay_t unbound = {0};
    zassert_equal(i_relay_get_status(&unbound, (relay_channel_t) 0, &status),
                  -EINVAL, "Unbound port must be rejected");

    /* NULL handle */
    zassert_equal(i_relay_get_status(NULL, (relay_channel_t) 0, &status),
                  -EINVAL, "NULL handle must be rejected");
}
```

## src/test_cwt_tm16pt.c
```c
/*
 * Copyright (c) 2026 DAECGE
 * SPDX-License-Identifier: Apache-2.0
 *
 * Unit tests for the CWT-TM-16PT temperature transmitter register decoder.
 */

#include <zephyr/ztest.h>
#include <string.h>

#include "domain/services/cwt_tm16pt_codec.h"

ZTEST_SUITE(cwt_tm16pt_suite, NULL, NULL, NULL, NULL, NULL);

ZTEST(cwt_tm16pt_suite, test_cwt_tm16pt_parse_scaled_normal)
{
    uint16_t simulated_regs[16];
    /* Channel 0: 254 = 25.4 C
     * Channel 1: 300 = 30.0 C
     * Channel 2: -150 = -15.0 C (int16 0xFF6A)
     * Channels 3-15: 200 = 20.0 C */
    simulated_regs[0] = 254;
    simulated_regs[1] = 300;
    simulated_regs[2] = (uint16_t)(-150);
    for (int i = 3; i < 16; i++) {
        simulated_regs[i] = 200;
    }

    temperature_bank_16ch_t bank;
    memset(&bank, 0, sizeof(bank));

    int err = cwt_tm16pt_parse_scaled_temperatures(simulated_regs, 16, &bank);
    zassert_equal(err, 0, "Parser returned error");
    zassert_true(bank.is_communication_valid, "Communication should be valid");
    zassert_equal(bank.open_probe_mask, 0, "No open probes expected");
    zassert_equal(bank.valid_channels_mask, 0xFFFF, "All 16 channels must be valid");

    zassert_within(bank.temperatures_c[0], 25.4f, 0.01f, "Ch0 mismatch");
    zassert_within(bank.temperatures_c[1], 30.0f, 0.01f, "Ch1 mismatch");
    zassert_within(bank.temperatures_c[2], -15.0f, 0.01f, "Ch2 negative temp mismatch");
    zassert_within(bank.temperatures_c[15], 20.0f, 0.01f, "Ch15 mismatch");
}

ZTEST(cwt_tm16pt_suite, test_cwt_tm16pt_parse_scaled_open_probe_detection)
{
    uint16_t simulated_regs[16];
    for (int i = 0; i < 16; i++) {
        simulated_regs[i] = 220; /* 22.0 C */
    }

    /* Channel 3: Disconnected probe (0x7FFF = 32767) */
    simulated_regs[3] = CWT_TM16PT_PROBE_OPEN_CODE;
    /* Channel 7: Broken probe sentinel (-32768) */
    simulated_regs[7] = 0x8000;

    temperature_bank_16ch_t bank;
    memset(&bank, 0, sizeof(bank));

    int err = cwt_tm16pt_parse_scaled_temperatures(simulated_regs, 16, &bank);
    zassert_equal(err, 0, "Parser returned error");

    /* Channel 3 and Channel 7 must be in open probe mask */
    uint16_t expected_open = (1U << 3) | (1U << 7);
    zassert_equal(bank.open_probe_mask, expected_open, "Open probe mask mismatch");

    /* Valid mask must NOT have bit 3 and 7 */
    zassert_false((bank.valid_channels_mask & (1U << 3)), "Ch3 must not be valid");
    zassert_false((bank.valid_channels_mask & (1U << 7)), "Ch7 must not be valid");
    zassert_true((bank.valid_channels_mask & (1U << 0)), "Ch0 must be valid");
}

ZTEST(cwt_tm16pt_suite, test_cwt_tm16pt_config_register_build_and_parse)
{
    uint16_t reg_val = 0;

    /* Build config: Slave ID 1, 9600 bps, None Parity (0) */
    int err = cwt_tm16pt_build_config_register(1, 9600, 0, &reg_val);
    zassert_equal(err, 0, "Build failed for default 9600 8N1");
    zassert_equal(reg_val, 0x0100, "Expected 0x0100 for ID 1, 9600, None");

    uint8_t out_id = 0, out_parity = 0;
    uint32_t out_baud = 0;
    err = cwt_tm16pt_parse_config_register(reg_val, &out_id, &out_baud, &out_parity);
    zassert_equal(err, 0, "Parse failed");
    zassert_equal(out_id, 1, "Slave ID mismatch");
    zassert_equal(out_baud, 9600, "Baudrate mismatch");
    zassert_equal(out_parity, 0, "Parity mismatch");

    /* Build config: Slave ID 10, 19200 bps (code 6), Even Parity (code 1) */
    /* low byte: 6 | (1 << 3) = 6 | 8 = 14 = 0x0E. High byte: 10 = 0x0A -> 0x0A0E */
    err = cwt_tm16pt_build_config_register(10, 19200, 1, &reg_val);
    zassert_equal(err, 0, "Build failed for 19200 Even");
    zassert_equal(reg_val, 0x0A0E, "Expected 0x0A0E for ID 10, 19200, Even");

    err = cwt_tm16pt_parse_config_register(reg_val, &out_id, &out_baud, &out_parity);
    zassert_equal(err, 0, "Parse failed");
    zassert_equal(out_id, 10, "Slave ID mismatch");
    zassert_equal(out_baud, 19200, "Baudrate mismatch");
    zassert_equal(out_parity, 1, "Parity mismatch");
}

ZTEST(cwt_tm16pt_suite, test_cwt_tm16pt_parse_float_normal_and_out_of_range)
{
    uint16_t simulated_regs[CWT_TM16PT_FLOAT_REG_COUNT];
    memset(simulated_regs, 0, sizeof(simulated_regs));

    /* Channel 0: 25.5 C = 0x41CC 0000 (big endian word order). */
    simulated_regs[0] = 0x41CCU;
    simulated_regs[1] = 0x0000U;

    /* Channel 1: -10.25 C = 0xC124 0000. */
    simulated_regs[2] = 0xC124U;
    simulated_regs[3] = 0x0000U;

    /* Channel 2: 0.0 C, a valid reading, not an open probe. */
    simulated_regs[4] = 0x0000U;
    simulated_regs[5] = 0x0000U;

    /* Channel 3: 1000.0 C = 0x447A 0000, outside the transmitter range. */
    simulated_regs[6] = 0x447AU;
    simulated_regs[7] = 0x0000U;

    temperature_bank_16ch_t bank;
    memset(&bank, 0, sizeof(bank));

    int err = cwt_tm16pt_parse_float_temperatures(simulated_regs, CWT_TM16PT_FLOAT_REG_COUNT,
                                                 &bank);
    zassert_equal(err, 0, "Float parser returned error");
    zassert_true(bank.is_communication_valid, "Communication should be valid");

    zassert_within(bank.temperatures_c[0], 25.5f, 0.001f, "Ch0 mismatched");
    zassert_within(bank.temperatures_c[1], -10.25f, 0.001f, "Ch1 negative mismatched");
    zassert_within(bank.temperatures_c[2], 0.0f, 0.001f, "Ch2 zero mismatched");

    zassert_true((bank.valid_channels_mask & (1U << 0)), "Ch0 must be valid");
    zassert_true((bank.valid_channels_mask & (1U << 1)), "Ch1 must be valid");
    zassert_true((bank.valid_channels_mask & (1U << 2)), "Ch2 must be valid");

    /* Out of range in float mode is reported as an open probe, not as a value. */
    zassert_true((bank.open_probe_mask & (1U << 3)), "Ch3 must be flagged");
    zassert_false((bank.valid_channels_mask & (1U << 3)), "Ch3 must not be valid");
}

ZTEST(cwt_tm16pt_suite, test_cwt_tm16pt_parsers_reject_bad_arguments)
{
    uint16_t regs[CWT_TM16PT_FLOAT_REG_COUNT] = {0};
    temperature_bank_16ch_t bank;
    uint16_t config_reg = 0U;

    memset(&bank, 0, sizeof(bank));

    zassert_equal(cwt_tm16pt_parse_scaled_temperatures(NULL, CWT_TM16PT_SCALED_REG_COUNT, &bank),
                  -EINVAL, "NULL registers must be rejected");
    zassert_equal(cwt_tm16pt_parse_scaled_temperatures(regs, CWT_TM16PT_SCALED_REG_COUNT, NULL),
                  -EINVAL, "NULL destination must be rejected");
    zassert_equal(cwt_tm16pt_parse_scaled_temperatures(regs, CWT_TM16PT_SCALED_REG_COUNT - 1U,
                                                      &bank),
                  -EINVAL, "A short register block must be rejected");

    zassert_equal(cwt_tm16pt_parse_float_temperatures(NULL, CWT_TM16PT_FLOAT_REG_COUNT, &bank),
                  -EINVAL, "NULL registers must be rejected");
    zassert_equal(cwt_tm16pt_parse_float_temperatures(regs, CWT_TM16PT_FLOAT_REG_COUNT - 1U, &bank),
                  -EINVAL, "A short float block must be rejected");

    zassert_equal(cwt_tm16pt_build_config_register(0U, 9600U, 0U, &config_reg), -EINVAL,
                  "Slave address 0 must be rejected");
    zassert_equal(cwt_tm16pt_build_config_register(1U, 9600U, 0U, NULL), -EINVAL,
                  "NULL register output must be rejected");
    zassert_equal(cwt_tm16pt_build_config_register(1U, 600U, 0U, &config_reg), -EINVAL,
                  "An unsupported baud rate must be rejected");
    zassert_equal(cwt_tm16pt_build_config_register(1U, 9600U, 9U, &config_reg), -EINVAL,
                  "An unsupported parity must be rejected");

    zassert_equal(cwt_tm16pt_parse_config_register(0x0100U, NULL, NULL, NULL), -EINVAL,
                  "NULL outputs must be rejected");
}
```

## src/test_jsy_mk339_codec.c
```c
/*
 * Copyright (c) 2026 DAECGE
 * SPDX-License-Identifier: Apache-2.0
 *
 * Unit tests for the JSY-MK-339 energy meter register codec and port contracts.
 */

#include <zephyr/ztest.h>
#include <string.h>

#include "domain/services/jsy_mk339_codec.h"
#include "interfaces/i_energy_meter.h"
#include "fake_energy_meter.h"

ZTEST_SUITE(jsy_mk339_suite, NULL, NULL, NULL, NULL, NULL);

ZTEST(jsy_mk339_suite, test_jsy_mk339_parse_electrical_parameters_full_block)
{
    uint16_t regs[JSY_MK339_ELECTRICAL_FULL_REG_COUNT];
    memset(regs, 0, sizeof(regs));

    /* Voltages: 0x0048..0x004A (/ 100) */
    regs[0] = 23000; /* Va = 230.00 V */
    regs[1] = 23150; /* Vb = 231.50 V */
    regs[2] = 22980; /* Vc = 229.80 V */

    /* Currents: 0x004B..0x004D (/ 100) */
    regs[3] = 1050;  /* Ia = 10.50 A */
    regs[4] = 1020;  /* Ib = 10.20 A */
    regs[5] = 1080;  /* Ic = 10.80 A */

    /* Leakage current: 0x004E (/ 10000) */
    regs[6] = 150;   /* I_leak = 0.0150 A */

    /* Active powers: 0x004F..0x0052 (/ 100, kW) */
    regs[7] = 241;   /* Pa = 2.41 kW */
    regs[8] = 236;   /* Pb = 2.36 kW */
    regs[9] = 248;   /* Pc = 2.48 kW */
    regs[10] = 725;  /* P_total = 7.25 kW */

    /* Reactive powers: 0x0053..0x0056 (/ 100, kVar) */
    regs[11] = 31;   /* Qa = 0.31 kVar */
    regs[12] = 30;   /* Qb = 0.30 kVar */
    regs[13] = 32;   /* Qc = 0.32 kVar */
    regs[14] = 93;   /* Q_total = 0.93 kVar */

    /* Apparent powers: 0x0057..0x005A (/ 100, kVA) */
    regs[15] = 243;  /* Sa = 2.43 kVA */
    regs[16] = 238;  /* Sb = 2.38 kVA */
    regs[17] = 250;  /* Sc = 2.50 kVA */
    regs[18] = 731;  /* S_total = 7.31 kVA */

    /* Power factors: 0x005B..0x005E (/ 1000) */
    regs[19] = 992;  /* PFa = 0.992 */
    regs[20] = 991;  /* PFb = 0.991 */
    regs[21] = 992;  /* PFc = 0.992 */
    regs[22] = 992;  /* PF_total = 0.992 */

    /* Active energies: 0x005F..0x0066 (U32 BE / 100, kWh) */
    /* Phase A: 12345.67 kWh -> raw = 1234567 = 0x0012D687 */
    regs[23] = 0x0012;
    regs[24] = 0xD687;
    /* Phase B: 20000.00 kWh -> raw = 2000000 = 0x001E8480 */
    regs[25] = 0x001E;
    regs[26] = 0x8480;
    /* Phase C: 30000.00 kWh -> raw = 3000000 = 0x002DC6C0 */
    regs[27] = 0x002D;
    regs[28] = 0xC6C0;
    /* Total: 62345.67 kWh -> raw = 6234567 = 0x005F21C7 */
    regs[29] = 0x005F;
    regs[30] = 0x21C7;

    /* Reactive energies: 0x0067..0x006E (U32 BE / 100, kvarh) */
    /* Total: 5000.00 kvarh -> raw = 500000 = 0x0007A120 */
    regs[37] = 0x0007;
    regs[38] = 0xA120;

    /* Apparent energies: 0x006F..0x0076 (U32 BE / 100, kVAh) */
    /* Total: 6500.00 kVAh -> raw = 650000 = 0x0009EB10 */
    regs[45] = 0x0009;
    regs[46] = 0xEB10;

    /* Frequency: 0x0077 (/ 100, Hz) */
    regs[47] = 5000; /* 50.00 Hz */

    energy_reading_t reading;
    memset(&reading, 0, sizeof(reading));

    int err = jsy_mk339_parse_electrical_parameters(regs, JSY_MK339_ELECTRICAL_FULL_REG_COUNT,
                                                    &reading);
    zassert_equal(err, 0, "Parser returned error: %d", err);
    zassert_true(reading.is_valid, "Reading must be valid");

    /* Voltages */
    zassert_within(reading.voltage_v[ENERGY_PHASE_A], 230.00f, 0.01f, "Va mismatch");
    zassert_within(reading.voltage_v[ENERGY_PHASE_B], 231.50f, 0.01f, "Vb mismatch");
    zassert_within(reading.voltage_v[ENERGY_PHASE_C], 229.80f, 0.01f, "Vc mismatch");

    /* Currents */
    zassert_within(reading.current_a[ENERGY_PHASE_A], 10.50f, 0.01f, "Ia mismatch");
    zassert_within(reading.current_a[ENERGY_PHASE_B], 10.20f, 0.01f, "Ib mismatch");
    zassert_within(reading.current_a[ENERGY_PHASE_C], 10.80f, 0.01f, "Ic mismatch");
    zassert_within(reading.leakage_current_a, 0.0150f, 0.0001f, "Leakage current mismatch");

    /* Active powers */
    zassert_within(reading.active_power_kw[ENERGY_PHASE_A], 2.41f, 0.01f, "Pa mismatch");
    zassert_within(reading.active_power_kw[ENERGY_PHASE_B], 2.36f, 0.01f, "Pb mismatch");
    zassert_within(reading.active_power_kw[ENERGY_PHASE_C], 2.48f, 0.01f, "Pc mismatch");
    zassert_within(reading.total_active_power_kw, 7.25f, 0.01f, "Total active power mismatch");

    /* Reactive powers */
    zassert_within(reading.reactive_power_kvar[ENERGY_PHASE_A], 0.31f, 0.01f, "Qa mismatch");
    zassert_within(reading.total_reactive_power_kvar, 0.93f, 0.01f, "Total reactive power mismatch");

    /* Apparent powers */
    zassert_within(reading.apparent_power_kva[ENERGY_PHASE_A], 2.43f, 0.01f, "Sa mismatch");
    zassert_within(reading.total_apparent_power_kva, 7.31f, 0.01f, "Total apparent power mismatch");

    /* Power factors */
    zassert_within(reading.power_factor[ENERGY_PHASE_A], 0.992f, 0.001f, "PFa mismatch");
    zassert_within(reading.total_power_factor, 0.992f, 0.001f, "Total PF mismatch");

    /* Active energies */
    zassert_within(reading.active_energy_kwh[ENERGY_PHASE_A], 12345.67, 0.01, "Ea mismatch");
    zassert_within(reading.active_energy_kwh[ENERGY_PHASE_B], 20000.00, 0.01, "Eb mismatch");
    zassert_within(reading.active_energy_kwh[ENERGY_PHASE_C], 30000.00, 0.01, "Ec mismatch");
    zassert_within(reading.total_active_energy_kwh, 62345.67, 0.01, "Total active energy mismatch");

    /* Reactive energy */
    zassert_within(reading.total_reactive_energy_kvarh, 5000.00, 0.01, "Total reactive energy mismatch");

    /* Apparent energy */
    zassert_within(reading.total_apparent_energy_kvah, 6500.00, 0.01, "Total apparent energy mismatch");

    /* Frequency */
    zassert_within(reading.frequency_hz, 50.00f, 0.01f, "Frequency mismatch");
}

ZTEST(jsy_mk339_suite, test_jsy_mk339_parse_electrical_parameters_basic_block)
{
    uint16_t regs[JSY_MK339_ELECTRICAL_BASIC_REG_COUNT];
    memset(regs, 0, sizeof(regs));

    regs[0] = 22000; /* Va = 220.00 V */
    regs[3] = 500;   /* Ia = 5.00 A */
    regs[10] = 110;  /* P_total = 1.10 kW */
    regs[29] = 0x0001; /* Total energy: 1000.00 kWh (raw 100000 = 0x000186A0) */
    regs[30] = 0x86A0;

    energy_reading_t reading;
    memset(&reading, 0, sizeof(reading));

    int err = jsy_mk339_parse_electrical_parameters(regs, JSY_MK339_ELECTRICAL_BASIC_REG_COUNT,
                                                    &reading);
    zassert_equal(err, 0, "Basic block parser failed");
    zassert_true(reading.is_valid, "Reading must be valid");
    zassert_within(reading.voltage_v[ENERGY_PHASE_A], 220.00f, 0.01f, "Va mismatch");
    zassert_within(reading.current_a[ENERGY_PHASE_A], 5.00f, 0.01f, "Ia mismatch");
    zassert_within(reading.total_active_power_kw, 1.10f, 0.01f, "Total P mismatch");
    zassert_within(reading.total_active_energy_kwh, 1000.00, 0.01, "Total E mismatch");
    zassert_equal(reading.frequency_hz, 0.0f, "Frequency should be 0 when not in basic block");
}

ZTEST(jsy_mk339_suite, test_jsy_mk339_parse_rejects_invalid_arguments)
{
    uint16_t regs[JSY_MK339_ELECTRICAL_BASIC_REG_COUNT];
    energy_reading_t reading;

    zassert_equal(jsy_mk339_parse_electrical_parameters(NULL, JSY_MK339_ELECTRICAL_BASIC_REG_COUNT,
                                                        &reading),
                  -EINVAL, "NULL regs must be rejected");
    zassert_equal(jsy_mk339_parse_electrical_parameters(regs, JSY_MK339_ELECTRICAL_BASIC_REG_COUNT,
                                                        NULL),
                  -EINVAL, "NULL output must be rejected");
    zassert_equal(jsy_mk339_parse_electrical_parameters(regs, JSY_MK339_ELECTRICAL_BASIC_REG_COUNT - 1,
                                                        &reading),
                  -EINVAL, "Short buffer must be rejected");
}

ZTEST(jsy_mk339_suite, test_jsy_mk339_config_register_build_and_parse)
{
    uint16_t reg = 0U;

    /* Build: addr 1, 9600 bps -> 0x0106 */
    int err = jsy_mk339_build_config_register(1U, 9600U, &reg);
    zassert_equal(err, 0, "Build 9600 failed");
    zassert_equal(reg, 0x0106, "Expected 0x0106 for addr 1, 9600");

    uint8_t out_addr = 0U;
    uint32_t out_baud = 0U;
    err = jsy_mk339_parse_config_register(reg, &out_addr, &out_baud);
    zassert_equal(err, 0, "Parse 0x0106 failed");
    zassert_equal(out_addr, 1U, "Slave addr mismatch");
    zassert_equal(out_baud, 9600U, "Baudrate mismatch");

    /* Build: addr 2, 19200 bps -> 0x0207 */
    err = jsy_mk339_build_config_register(2U, 19200U, &reg);
    zassert_equal(err, 0, "Build 19200 failed");
    zassert_equal(reg, 0x0207, "Expected 0x0207 for addr 2, 19200");

    err = jsy_mk339_parse_config_register(reg, &out_addr, &out_baud);
    zassert_equal(err, 0, "Parse 0x0207 failed");
    zassert_equal(out_addr, 2U, "Slave addr mismatch");
    zassert_equal(out_baud, 19200U, "Baudrate mismatch");

    /* Build: addr 10, 4800 bps -> 0x0A05 */
    err = jsy_mk339_build_config_register(10U, 4800U, &reg);
    zassert_equal(err, 0, "Build 4800 failed");
    zassert_equal(reg, 0x0A05, "Expected 0x0A05 for addr 10, 4800");

    err = jsy_mk339_parse_config_register(reg, &out_addr, &out_baud);
    zassert_equal(err, 0, "Parse 0x0A05 failed");
    zassert_equal(out_addr, 10U, "Slave addr mismatch");
    zassert_equal(out_baud, 4800U, "Baudrate mismatch");
}

ZTEST(jsy_mk339_suite, test_jsy_mk339_config_register_rejects_invalid)
{
    uint16_t reg = 0U;
    uint8_t out_addr = 0U;
    uint32_t out_baud = 0U;

    zassert_equal(jsy_mk339_build_config_register(0U, 9600U, &reg), -EINVAL,
                  "Addr 0 must be rejected");
    zassert_equal(jsy_mk339_build_config_register(1U, 9600U, NULL), -EINVAL,
                  "NULL out_reg must be rejected");
    zassert_equal(jsy_mk339_build_config_register(1U, 115200U, &reg), -EINVAL,
                  "Unsupported baud must be rejected");

    zassert_equal(jsy_mk339_parse_config_register(0x0106, NULL, &out_baud), -EINVAL,
                  "NULL addr out must be rejected");
    zassert_equal(jsy_mk339_parse_config_register(0x0106, &out_addr, NULL), -EINVAL,
                  "NULL baud out must be rejected");
    zassert_equal(jsy_mk339_parse_config_register(0x0100, &out_addr, &out_baud), -EINVAL,
                  "Invalid baud code must be rejected");
}

ZTEST(jsy_mk339_suite, test_fake_energy_meter_port)
{
    /* Test unbound port validation per rule §4.1.D */
    i_energy_meter_t unbound = {0};
    energy_reading_t reading;
    memset(&reading, 0, sizeof(reading));

    zassert_equal(i_energy_meter_get_reading(&unbound, &reading), -EINVAL,
                  "Unbound handle must return -EINVAL");
    zassert_false(i_energy_meter_is_bound(&unbound), "Unbound port should report false");

    /* Setup fake */
    fake_energy_meter_reset();
    i_energy_meter_t port = fake_energy_meter_get_port();
    zassert_true(i_energy_meter_is_bound(&port), "Fake port must be bound");

    /* Null output */
    zassert_equal(i_energy_meter_get_reading(&port, NULL), -EINVAL,
                  "NULL output buffer must return -EINVAL");

    /* Set simulated reading */
    energy_reading_t sim_reading;
    memset(&sim_reading, 0, sizeof(sim_reading));
    sim_reading.device_id = 2U;
    sim_reading.total_active_power_kw = 15.75f;
    sim_reading.total_active_energy_kwh = 12345.6;
    sim_reading.is_valid = true;

    fake_energy_meter_set_reading(&sim_reading);

    zassert_equal(i_energy_meter_get_reading(&port, &reading), 0, "Get reading failed");
    zassert_equal(reading.device_id, 2U, "Device ID mismatch");
    zassert_within(reading.total_active_power_kw, 15.75f, 0.01f, "Active power mismatch");
    zassert_within(reading.total_active_energy_kwh, 12345.6, 0.01, "Active energy mismatch");
    zassert_true(reading.is_valid, "Validity mismatch");

    const fake_energy_meter_state_t *state = fake_energy_meter_get_state();
    zassert_equal(state->get_reading_calls, 1U, "Calls counter mismatch");

    /* Error override */
    fake_energy_meter_set_return_code(-EIO);
    zassert_equal(i_energy_meter_get_reading(&port, &reading), -EIO,
                  "Return code override failed");
}
```
