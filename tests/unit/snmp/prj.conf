## CMakeLists.txt
```
# SPDX-License-Identifier: Apache-2.0
cmake_minimum_required(VERSION 3.20.0)

list(APPEND EXTRA_ZEPHYR_MODULES "${CMAKE_CURRENT_SOURCE_DIR}/../../../../modules/lib/zephyr-snmp")

find_package(Zephyr REQUIRED HINTS $ENV{ZEPHYR_BASE})
project(unit_snmp_test)

set(APP_DIR ${CMAKE_CURRENT_SOURCE_DIR}/../../..)

target_sources(app PRIVATE
    src/test_snmp_telemetry.c
    src/test_snmp_traps.c
    ${APP_DIR}/app/src/infrastructure/adapters/adapter_snmp_telemetry.c
    ${APP_DIR}/app/src/infrastructure/adapters/adapter_snmp_traps.c
)

target_include_directories(app PRIVATE
    ${APP_DIR}/app/include
    ${APP_DIR}/app/src
    ${APP_DIR}/tests/fakes/include
    ${APP_DIR}/../modules/lib/zephyr-snmp/include
)
```

## prj.conf
```kconfig
# SPDX-License-Identifier: Apache-2.0
CONFIG_ZTEST=y
CONFIG_LOG=y

# Networking dependencies for snmp module
CONFIG_NETWORKING=y
CONFIG_NET_UDP=y
CONFIG_NET_SOCKETS=y
CONFIG_NET_SOCKETS_SERVICE=y
CONFIG_NET_IPV4=y

# SNMP Subsystem
CONFIG_SNMP_AGENT=y
CONFIG_SNMP_VERSION_1=y
CONFIG_SNMP_VERSION_2C=y
CONFIG_SNMP_MAX_INSTANCES=2
CONFIG_ZVFS_POLL_MAX=5
CONFIG_SNMP_MAX_MIB_NODES=128
CONFIG_SNMP_MAX_TABLES=8
CONFIG_SNMP_MAX_IFACES=8
CONFIG_SNMP_TRAP_ENABLED=y
CONFIG_SNMP_TRAP_DEST_COUNT=4

CONFIG_MAIN_STACK_SIZE=4096
CONFIG_ZTEST_STACK_SIZE=32768
```

## src/test_snmp_telemetry.c
```c
/*
 * Copyright (c) 2026 DAECGE
 * SPDX-License-Identifier: Apache-2.0
 */

#include <zephyr/ztest.h>
#include <string.h>
#include <stdio.h>

#include <snmp/snmp.h>
#include <snmp/snmp_core.h>
#include <snmp/snmp_mib.h>
#include <snmp/snmp_ber.h>

#include "infrastructure/adapters/adapter_snmp_telemetry.h"
#include "common/sensor_types.h"
#include "common/energy_types.h"
#include "common/thermal_energy_types.h"
#include "application/services/app_facade.h"

#define DAECGE_ENTERPRISE_ID 3134U
#define SNMP_OID_BASE 1, 3, 6, 1, 4, 1, DAECGE_ENTERPRISE_ID, 2, 3

/* =========================================================================
 * Mock Implementations for Facade Ports
 * ========================================================================= */

static thermal_energy_capture_t s_mock_thermal_capture;
static app_facade_hvac_status_t s_mock_hvac_status;
static energy_reading_t         s_mock_energy_reading;
static raw_sensor_readings_t    s_mock_raw_sensor;

static bool s_mock_thermal_ok = true;
static bool s_mock_hvac_ok = true;
static bool s_mock_energy_ok = true;
static bool s_mock_sensor_ok = true;

int app_facade_thermal_get_capture(thermal_energy_capture_t *out_capture)
{
    if (!s_mock_thermal_ok || out_capture == NULL) {
        return -EINVAL;
    }
    *out_capture = s_mock_thermal_capture;
    return 0;
}

int app_facade_hvac_get_status(app_facade_hvac_status_t *out_status)
{
    if (!s_mock_hvac_ok || out_status == NULL) {
        return -EINVAL;
    }
    *out_status = s_mock_hvac_status;
    return 0;
}

int app_facade_energy_get_reading(energy_reading_t *out_reading)
{
    if (!s_mock_energy_ok || out_reading == NULL) {
        return -EINVAL;
    }
    *out_reading = s_mock_energy_reading;
    return 0;
}

int app_facade_sensor_get_raw(raw_sensor_readings_t *out_raw)
{
    if (!s_mock_sensor_ok || out_raw == NULL) {
        return -EINVAL;
    }
    *out_raw = s_mock_raw_sensor;
    return 0;
}

/* =========================================================================
 * Test Suite Setup & Fixtures
 * ========================================================================= */

static struct snmp_agent s_agent;

static void *snmp_telemetry_setup(void)
{
    int rc = snmp_agent_init(&s_agent, NULL);
    zassert_equal(rc, 0, "snmp_agent_init failed: %d", rc);

    rc = adapter_snmp_telemetry_init(&s_agent);
    zassert_equal(rc, 0, "adapter_snmp_telemetry_init failed: %d", rc);

    return NULL;
}

static void snmp_telemetry_before(void *fixture)
{
    ARG_UNUSED(fixture);
    memset(&s_mock_thermal_capture, 0, sizeof(s_mock_thermal_capture));
    memset(&s_mock_hvac_status, 0, sizeof(s_mock_hvac_status));
    memset(&s_mock_energy_reading, 0, sizeof(s_mock_energy_reading));
    memset(&s_mock_raw_sensor, 0, sizeof(s_mock_raw_sensor));

    s_mock_thermal_ok = true;
    s_mock_hvac_ok = true;
    s_mock_energy_ok = true;
    s_mock_sensor_ok = true;
}

ZTEST_SUITE(snmp_telemetry_suite, NULL, snmp_telemetry_setup, snmp_telemetry_before, NULL, NULL);

/* =========================================================================
 * Test Cases
 * ========================================================================= */

ZTEST(snmp_telemetry_suite, test_scalar_process_temperatures)
{
    /* Setup thermal capture mock data */
    s_mock_thermal_capture.inj_valid_mask = 0xFFFF;
    s_mock_thermal_capture.ret_valid_mask = 0xFFFF;
    s_mock_thermal_capture.pair_valid_mask = 0xFFFF;
    s_mock_thermal_capture.room_valid_mask = 0x03;
    s_mock_thermal_capture.outdoor_valid_mask = 0x01;
    s_mock_thermal_capture.humidity_return_pct = 52.4f;

    /* Units 1..4 */
    s_mock_thermal_capture.t_inj[0] = 12.5f;
    s_mock_thermal_capture.t_ret[0] = 24.0f;
    s_mock_thermal_capture.t_inj[1] = 13.0f;
    s_mock_thermal_capture.t_ret[1] = 24.5f;
    s_mock_thermal_capture.t_inj[2] = 13.5f;
    s_mock_thermal_capture.t_ret[2] = 25.0f;
    s_mock_thermal_capture.t_inj[3] = 14.0f;
    s_mock_thermal_capture.t_ret[3] = 25.5f;

    /* Units 5..8 */
    s_mock_thermal_capture.t_inj[4] = 14.5f;
    s_mock_thermal_capture.t_ret[4] = 26.0f;
    s_mock_thermal_capture.t_inj[5] = 15.0f;
    s_mock_thermal_capture.t_ret[5] = 26.5f;
    s_mock_thermal_capture.t_inj[6] = 15.5f;
    s_mock_thermal_capture.t_ret[6] = 27.0f;
    s_mock_thermal_capture.t_inj[7] = 16.0f;
    s_mock_thermal_capture.t_ret[7] = 27.5f;

    s_mock_thermal_capture.t_room[0] = 22.3f;
    s_mock_thermal_capture.t_room[1] = 22.8f;
    s_mock_thermal_capture.t_outdoor[0] = 34.6f;

    /* Setup HVAC status mock data (Control Temps for Groups 1..4) */
    s_mock_hvac_status.total_groups = 4;
    s_mock_hvac_status.groups[0].highest_temp = 23.1f;
    s_mock_hvac_status.groups[1].highest_temp = 24.2f;
    s_mock_hvac_status.groups[2].highest_temp = 22.0f;
    s_mock_hvac_status.groups[3].highest_temp = 25.5f;

    struct snmp_varbind vb;

    /* 1. Unit 1 Evap Supply (subid 1) -> 125 */
    struct snmp_oid oid_s1 = {.len = 13, .ids = {SNMP_OID_BASE, 2, 2, 1, 0}};
    memset(&vb, 0, sizeof(vb));
    zassert_equal(snmp_mib_get(&s_agent, &oid_s1, &vb), 0, "Get failed");
    zassert_equal(vb.type, ASN1_TAG_INTEGER, "Type mismatch");
    zassert_equal(vb.val.int_val, 125, "tempSupplyEvap1 mismatch");

    /* 2. Unit 1 Evap Return (subid 2) -> 240 */
    struct snmp_oid oid_r1 = {.len = 13, .ids = {SNMP_OID_BASE, 2, 2, 2, 0}};
    memset(&vb, 0, sizeof(vb));
    zassert_equal(snmp_mib_get(&s_agent, &oid_r1, &vb), 0, "Get failed");
    zassert_equal(vb.val.int_val, 240, "tempReturnEvap1 mismatch");

    /* 3. Unit 1 Evap Delta T (subid 3) -> 115 */
    struct snmp_oid oid_d1 = {.len = 13, .ids = {SNMP_OID_BASE, 2, 2, 3, 0}};
    memset(&vb, 0, sizeof(vb));
    zassert_equal(snmp_mib_get(&s_agent, &oid_d1, &vb), 0, "Get failed");
    zassert_equal(vb.val.int_val, 115, "tempDeltaEvap1 mismatch");

    /* 4. Room Ambient 1 (subid 13) -> 223 */
    struct snmp_oid oid_room1 = {.len = 13, .ids = {SNMP_OID_BASE, 2, 2, 13, 0}};
    memset(&vb, 0, sizeof(vb));
    zassert_equal(snmp_mib_get(&s_agent, &oid_room1, &vb), 0, "Get failed");
    zassert_equal(vb.val.int_val, 223, "tempRoomAmbient1 mismatch");

    /* 5. Return Grille Humidity (subid 16) -> 524 (Gauge32) */
    struct snmp_oid oid_hum = {.len = 13, .ids = {SNMP_OID_BASE, 2, 2, 16, 0}};
    memset(&vb, 0, sizeof(vb));
    zassert_equal(snmp_mib_get(&s_agent, &oid_hum, &vb), 0, "Get failed");
    zassert_equal(vb.type, SNMP_TAG_GAUGE32, "Type mismatch for humidity");
    zassert_equal(vb.val.uint_val, 524, "humidityReturnGrille mismatch");

    /* 6. HVAC Control Temps (subids 17..20 -> Salas 1..4) */
    struct snmp_oid oid_ctrl1 = {.len = 13, .ids = {SNMP_OID_BASE, 2, 2, 17, 0}};
    memset(&vb, 0, sizeof(vb));
    zassert_equal(snmp_mib_get(&s_agent, &oid_ctrl1, &vb), 0, "Get failed");
    zassert_equal(vb.val.int_val, 231, "tempControlGroup1 mismatch");

    struct snmp_oid oid_ctrl2 = {.len = 13, .ids = {SNMP_OID_BASE, 2, 2, 18, 0}};
    memset(&vb, 0, sizeof(vb));
    zassert_equal(snmp_mib_get(&s_agent, &oid_ctrl2, &vb), 0, "Get failed");
    zassert_equal(vb.val.int_val, 242, "tempControlGroup2 mismatch");

    struct snmp_oid oid_ctrl3 = {.len = 13, .ids = {SNMP_OID_BASE, 2, 2, 19, 0}};
    memset(&vb, 0, sizeof(vb));
    zassert_equal(snmp_mib_get(&s_agent, &oid_ctrl3, &vb), 0, "Get failed");
    zassert_equal(vb.val.int_val, 220, "tempControlGroup3 mismatch");

    struct snmp_oid oid_ctrl4 = {.len = 13, .ids = {SNMP_OID_BASE, 2, 2, 20, 0}};
    memset(&vb, 0, sizeof(vb));
    zassert_equal(snmp_mib_get(&s_agent, &oid_ctrl4, &vb), 0, "Get failed");
    zassert_equal(vb.val.int_val, 255, "tempControlGroup4 mismatch");

    /* 7. Units 5..8 Evaporator Temperatures (subids 21..32) */
    /* Unit 5 */
    struct snmp_oid oid_s5 = {.len = 13, .ids = {SNMP_OID_BASE, 2, 2, 21, 0}};
    memset(&vb, 0, sizeof(vb));
    zassert_equal(snmp_mib_get(&s_agent, &oid_s5, &vb), 0, "Get failed");
    zassert_equal(vb.val.int_val, 145, "tempSupplyEvap5 mismatch");

    struct snmp_oid oid_r5 = {.len = 13, .ids = {SNMP_OID_BASE, 2, 2, 22, 0}};
    memset(&vb, 0, sizeof(vb));
    zassert_equal(snmp_mib_get(&s_agent, &oid_r5, &vb), 0, "Get failed");
    zassert_equal(vb.val.int_val, 260, "tempReturnEvap5 mismatch");

    struct snmp_oid oid_d5 = {.len = 13, .ids = {SNMP_OID_BASE, 2, 2, 23, 0}};
    memset(&vb, 0, sizeof(vb));
    zassert_equal(snmp_mib_get(&s_agent, &oid_d5, &vb), 0, "Get failed");
    zassert_equal(vb.val.int_val, 115, "tempDeltaEvap5 mismatch");

    /* Unit 8 */
    struct snmp_oid oid_s8 = {.len = 13, .ids = {SNMP_OID_BASE, 2, 2, 30, 0}};
    memset(&vb, 0, sizeof(vb));
    zassert_equal(snmp_mib_get(&s_agent, &oid_s8, &vb), 0, "Get failed");
    zassert_equal(vb.val.int_val, 160, "tempSupplyEvap8 mismatch");

    struct snmp_oid oid_r8 = {.len = 13, .ids = {SNMP_OID_BASE, 2, 2, 31, 0}};
    memset(&vb, 0, sizeof(vb));
    zassert_equal(snmp_mib_get(&s_agent, &oid_r8, &vb), 0, "Get failed");
    zassert_equal(vb.val.int_val, 275, "tempReturnEvap8 mismatch");

    struct snmp_oid oid_d8 = {.len = 13, .ids = {SNMP_OID_BASE, 2, 2, 32, 0}};
    memset(&vb, 0, sizeof(vb));
    zassert_equal(snmp_mib_get(&s_agent, &oid_d8, &vb), 0, "Get failed");
    zassert_equal(vb.val.int_val, 115, "tempDeltaEvap8 mismatch");
}

ZTEST(snmp_telemetry_suite, test_scalar_process_temperatures_invalid)
{
    /* When mask is 0 or sensor is disconnected, return sentinel -9999 */
    s_mock_thermal_capture.inj_valid_mask = 0;
    s_mock_thermal_capture.ret_valid_mask = 0;
    s_mock_thermal_capture.pair_valid_mask = 0;

    struct snmp_varbind vb;
    struct snmp_oid oid = {.len = 13, .ids = {SNMP_OID_BASE, 2, 2, 1, 0}};
    memset(&vb, 0, sizeof(vb));
    zassert_equal(snmp_mib_get(&s_agent, &oid, &vb), 0, "Get failed");
    zassert_equal(vb.val.int_val, -9999, "Must return sentinel -9999 on invalid sensor");

    /* When facade returns error */
    s_mock_thermal_ok = false;
    memset(&vb, 0, sizeof(vb));
    zassert_equal(snmp_mib_get(&s_agent, &oid, &vb), 0, "Get failed");
    zassert_equal(vb.val.int_val, -9999, "Must return sentinel -9999 on facade failure");
}

ZTEST(snmp_telemetry_suite, test_scalar_energy_telemetry)
{
    s_mock_energy_reading.is_valid = true;
    s_mock_energy_reading.frequency_hz = 60.05f;
    s_mock_energy_reading.voltage_v[0] = 220.4f;
    s_mock_energy_reading.voltage_v[1] = 221.1f;
    s_mock_energy_reading.voltage_v[2] = 219.7f;
    s_mock_energy_reading.current_a[0] = 15.250f;
    s_mock_energy_reading.current_a[1] = 14.800f;
    s_mock_energy_reading.current_a[2] = 15.100f;
    s_mock_energy_reading.leakage_current_a = 0.035f;
    s_mock_energy_reading.active_power_kw[0] = 3.200f;
    s_mock_energy_reading.active_power_kw[1] = 3.100f;
    s_mock_energy_reading.active_power_kw[2] = 3.300f;
    s_mock_energy_reading.total_active_power_kw = 9.600f;
    s_mock_energy_reading.total_reactive_power_kvar = 2.150f;
    s_mock_energy_reading.total_apparent_power_kva = 9.850f;
    s_mock_energy_reading.power_factor[0] = 0.952f;
    s_mock_energy_reading.power_factor[1] = 0.941f;
    s_mock_energy_reading.power_factor[2] = 0.963f;
    s_mock_energy_reading.total_power_factor = 0.955f;
    s_mock_energy_reading.total_active_energy_kwh = 12345.67;
    s_mock_energy_reading.total_reactive_energy_kvarh = 987.65;

    struct snmp_varbind vb;

    /* 1. energyCommStatus (subid 1) -> 1 (commOk) */
    struct snmp_oid oid_comm = {.len = 12, .ids = {SNMP_OID_BASE, 6, 1, 0}};
    memset(&vb, 0, sizeof(vb));
    zassert_equal(snmp_mib_get(&s_agent, &oid_comm, &vb), 0, "Get failed");
    zassert_equal(vb.val.int_val, 1, "energyCommStatus mismatch");

    /* 2. energyLineFrequency (subid 2) -> 601 (60.05 * 10 rounded) */
    struct snmp_oid oid_hz = {.len = 12, .ids = {SNMP_OID_BASE, 6, 2, 0}};
    memset(&vb, 0, sizeof(vb));
    zassert_equal(snmp_mib_get(&s_agent, &oid_hz, &vb), 0, "Get failed");
    zassert_equal(vb.val.int_val, 601, "energyLineFrequency mismatch");

    /* 3. voltagePhaseA (subid 3) -> 2204 */
    struct snmp_oid oid_va = {.len = 12, .ids = {SNMP_OID_BASE, 6, 3, 0}};
    memset(&vb, 0, sizeof(vb));
    zassert_equal(snmp_mib_get(&s_agent, &oid_va, &vb), 0, "Get failed");
    zassert_equal(vb.val.int_val, 2204, "voltagePhaseA mismatch");

    /* 4. currentPhaseA (subid 6) -> 153 (tenths of A, Gauge32) */
    struct snmp_oid oid_ia = {.len = 12, .ids = {SNMP_OID_BASE, 6, 6, 0}};
    memset(&vb, 0, sizeof(vb));
    zassert_equal(snmp_mib_get(&s_agent, &oid_ia, &vb), 0, "Get failed");
    zassert_equal(vb.type, SNMP_TAG_GAUGE32, "Type mismatch for currentPhaseA");
    zassert_equal(vb.val.uint_val, 153, "currentPhaseA mismatch");

    /* 5. totalActivePower (subid 13) -> 9600 W */
    struct snmp_oid oid_ptot = {.len = 12, .ids = {SNMP_OID_BASE, 6, 13, 0}};
    memset(&vb, 0, sizeof(vb));
    zassert_equal(snmp_mib_get(&s_agent, &oid_ptot, &vb), 0, "Get failed");
    zassert_equal(vb.val.int_val, 9600, "totalActivePower mismatch");

    /* 6. totalPowerFactor (subid 19) -> 96 (-100..100) */
    struct snmp_oid oid_pf = {.len = 12, .ids = {SNMP_OID_BASE, 6, 19, 0}};
    memset(&vb, 0, sizeof(vb));
    zassert_equal(snmp_mib_get(&s_agent, &oid_pf, &vb), 0, "Get failed");
    zassert_equal(vb.val.int_val, 96, "totalPowerFactor mismatch");

    /* 7. totalActiveEnergyKwh (subid 20) -> 12346 (kWh, Gauge32) */
    struct snmp_oid oid_kwh = {.len = 12, .ids = {SNMP_OID_BASE, 6, 20, 0}};
    memset(&vb, 0, sizeof(vb));
    zassert_equal(snmp_mib_get(&s_agent, &oid_kwh, &vb), 0, "Get failed");
    zassert_equal(vb.type, SNMP_TAG_GAUGE32, "Type mismatch for totalActiveEnergyKwh");
    zassert_equal(vb.val.uint_val, 12346, "totalActiveEnergyKwh mismatch");
}

ZTEST(snmp_telemetry_suite, test_hvac_group_table)
{
    /* Configure HVAC Group Table data */
    s_mock_hvac_status.total_groups = 4;

    /* Sala 1: Cooling, 23.5 C, setpoints 19/24/26/28, sensors 1..4 (4 sensors), 2 active units */
    s_mock_hvac_status.groups[0].state = GROUP_STATE_COOLING;
    s_mock_hvac_status.groups[0].highest_temp = 23.5f;
    s_mock_hvac_status.groups[0].temp_min = 19.0f;
    s_mock_hvac_status.groups[0].temp_max = 24.0f;
    s_mock_hvac_status.groups[0].temp_alarm = 26.0f;
    s_mock_hvac_status.groups[0].temp_bypass = 28.0f;
    s_mock_hvac_status.groups[0].sensor_start = 1;
    s_mock_hvac_status.groups[0].sensor_end = 4;
    s_mock_hvac_status.groups[0].active_turn_count = 2;

    /* Sala 2: CoolBoost, 26.2 C, setpoints 20/24/26/28, sensors 5..8, 3 active units */
    s_mock_hvac_status.groups[1].state = GROUP_STATE_COOL_BOOST;
    s_mock_hvac_status.groups[1].highest_temp = 26.2f;
    s_mock_hvac_status.groups[1].temp_min = 20.0f;
    s_mock_hvac_status.groups[1].temp_max = 24.0f;
    s_mock_hvac_status.groups[1].temp_alarm = 26.0f;
    s_mock_hvac_status.groups[1].temp_bypass = 28.0f;
    s_mock_hvac_status.groups[1].sensor_start = 5;
    s_mock_hvac_status.groups[1].sensor_end = 8;
    s_mock_hvac_status.groups[1].active_turn_count = 3;

    struct snmp_varbind vb;

    /* Base table entry: 1.3.6.1.4.1.3134.2.3.3.2.1.<col>.<row> (14 subids) */

    /* Row 1, Col 1 (Index) */
    struct snmp_oid oid_c1_r1 = {.len = 14, .ids = {SNMP_OID_BASE, 3, 2, 1, 1, 1}};
    memset(&vb, 0, sizeof(vb));
    zassert_equal(snmp_mib_get(&s_agent, &oid_c1_r1, &vb), 0, "Get failed");
    zassert_equal(vb.val.int_val, 1, "hvacGroupIndex mismatch");

    /* Row 1, Col 2 (Name) */
    struct snmp_oid oid_c2_r1 = {.len = 14, .ids = {SNMP_OID_BASE, 3, 2, 1, 2, 1}};
    memset(&vb, 0, sizeof(vb));
    zassert_equal(snmp_mib_get(&s_agent, &oid_c2_r1, &vb), 0, "Get failed");
    zassert_equal(vb.type, ASN1_TAG_OCTET_STRING, "Type mismatch");
    zassert_mem_equal(vb.val.octet_str.data, "HVAC Group 1 (Sala 1)", vb.val.octet_str.len, "Name mismatch");

    /* Row 1, Col 3 (State): cooling -> 3 + 1 = 4 (or MIB enum cooling(3)) */
    struct snmp_oid oid_c3_r1 = {.len = 14, .ids = {SNMP_OID_BASE, 3, 2, 1, 3, 1}};
    memset(&vb, 0, sizeof(vb));
    zassert_equal(snmp_mib_get(&s_agent, &oid_c3_r1, &vb), 0, "Get failed");
    zassert_true(vb.val.int_val >= 1 && vb.val.int_val <= 7, "State out of enum bounds");

    /* Row 1, Col 4 (Control Temp) -> 235 */
    struct snmp_oid oid_c4_r1 = {.len = 14, .ids = {SNMP_OID_BASE, 3, 2, 1, 4, 1}};
    memset(&vb, 0, sizeof(vb));
    zassert_equal(snmp_mib_get(&s_agent, &oid_c4_r1, &vb), 0, "Get failed");
    zassert_equal(vb.val.int_val, 235, "Control Temp mismatch");

    /* Row 1, Col 5 (TempMin) -> 190 */
    struct snmp_oid oid_c5_r1 = {.len = 14, .ids = {SNMP_OID_BASE, 3, 2, 1, 5, 1}};
    memset(&vb, 0, sizeof(vb));
    zassert_equal(snmp_mib_get(&s_agent, &oid_c5_r1, &vb), 0, "Get failed");
    zassert_equal(vb.val.int_val, 190, "TempMin mismatch");

    /* Row 1, Col 6 (TempMax) -> 240 */
    struct snmp_oid oid_c6_r1 = {.len = 14, .ids = {SNMP_OID_BASE, 3, 2, 1, 6, 1}};
    memset(&vb, 0, sizeof(vb));
    zassert_equal(snmp_mib_get(&s_agent, &oid_c6_r1, &vb), 0, "Get failed");
    zassert_equal(vb.val.int_val, 240, "TempMax mismatch");

    /* Row 1, Col 7 (TempAlarm) -> 260 */
    struct snmp_oid oid_c7_r1 = {.len = 14, .ids = {SNMP_OID_BASE, 3, 2, 1, 7, 1}};
    memset(&vb, 0, sizeof(vb));
    zassert_equal(snmp_mib_get(&s_agent, &oid_c7_r1, &vb), 0, "Get failed");
    zassert_equal(vb.val.int_val, 260, "TempAlarm mismatch");

    /* Row 1, Col 8 (TempBypass) -> 280 */
    struct snmp_oid oid_c8_r1 = {.len = 14, .ids = {SNMP_OID_BASE, 3, 2, 1, 8, 1}};
    memset(&vb, 0, sizeof(vb));
    zassert_equal(snmp_mib_get(&s_agent, &oid_c8_r1, &vb), 0, "Get failed");
    zassert_equal(vb.val.int_val, 280, "TempBypass mismatch");

    /* Row 1, Col 9 (Valid Sensors) -> 4 */
    struct snmp_oid oid_c9_r1 = {.len = 14, .ids = {SNMP_OID_BASE, 3, 2, 1, 9, 1}};
    memset(&vb, 0, sizeof(vb));
    zassert_equal(snmp_mib_get(&s_agent, &oid_c9_r1, &vb), 0, "Get failed");
    zassert_equal(vb.val.int_val, 4, "Valid Sensors count mismatch");

    /* Row 1, Col 10 (Active Units) -> 2 */
    struct snmp_oid oid_c10_r1 = {.len = 14, .ids = {SNMP_OID_BASE, 3, 2, 1, 10, 1}};
    memset(&vb, 0, sizeof(vb));
    zassert_equal(snmp_mib_get(&s_agent, &oid_c10_r1, &vb), 0, "Get failed");
    zassert_equal(vb.val.int_val, 2, "Active Units count mismatch");

    /* Row 2, Col 4 (Control Temp for Sala 2) -> 262 */
    struct snmp_oid oid_c4_r2 = {.len = 14, .ids = {SNMP_OID_BASE, 3, 2, 1, 4, 2}};
    memset(&vb, 0, sizeof(vb));
    zassert_equal(snmp_mib_get(&s_agent, &oid_c4_r2, &vb), 0, "Get failed");
    zassert_equal(vb.val.int_val, 262, "Sala 2 Control Temp mismatch");

    /* Non-existent Row 5 -> NoSuchInstance */
    struct snmp_oid oid_c1_r5 = {.len = 14, .ids = {SNMP_OID_BASE, 3, 2, 1, 1, 5}};
    memset(&vb, 0, sizeof(vb));
    zassert_equal(snmp_mib_get(&s_agent, &oid_c1_r5, &vb), 0, "Get failed");
    zassert_equal(vb.type, SNMP_TAG_EXCEPT_NO_SUCH_INST, "Row 5 must return NoSuchInstance");
}

ZTEST(snmp_telemetry_suite, test_key_sensor_table)
{
    /* Configure raw sensor readings */
    s_mock_raw_sensor.cwt_comm_ok[0] = true;
    s_mock_raw_sensor.cwt_temperatures_c[0][0] = 23.4f;
    s_mock_raw_sensor.cwt_valid_mask[0] = 0x0001;
    s_mock_raw_sensor.cwt_open_probe_mask[0] = 0x0000;

    struct snmp_varbind vb;

    /* Base sensor table entry: 1.3.6.1.4.1.3134.2.3.2.1.1.<col>.<row> (14 subids) */

    /* Row 1, Col 1 (Index) */
    struct snmp_oid oid_c1_r1 = {.len = 14, .ids = {SNMP_OID_BASE, 2, 1, 1, 1, 1}};
    memset(&vb, 0, sizeof(vb));
    zassert_equal(snmp_mib_get(&s_agent, &oid_c1_r1, &vb), 0, "Get failed");
    zassert_equal(vb.val.int_val, 1, "Index mismatch");

    /* Row 1, Col 5 (Value in 0.1 C) -> 234 */
    struct snmp_oid oid_c5_r1 = {.len = 14, .ids = {SNMP_OID_BASE, 2, 1, 1, 5, 1}};
    memset(&vb, 0, sizeof(vb));
    zassert_equal(snmp_mib_get(&s_agent, &oid_c5_r1, &vb), 0, "Get failed");
    zassert_equal(vb.val.int_val, 234, "Value mismatch");

    /* Row 1, Col 6 (Status): 1=normal */
    struct snmp_oid oid_c6_r1 = {.len = 14, .ids = {SNMP_OID_BASE, 2, 1, 1, 6, 1}};
    memset(&vb, 0, sizeof(vb));
    zassert_equal(snmp_mib_get(&s_agent, &oid_c6_r1, &vb), 0, "Get failed");
    zassert_equal(vb.val.int_val, 1, "Status normal mismatch");

    /* Disconnect sensor probe -> status=2 (openProbe) */
    s_mock_raw_sensor.cwt_open_probe_mask[0] = 0x0001;
    memset(&vb, 0, sizeof(vb));
    zassert_equal(snmp_mib_get(&s_agent, &oid_c6_r1, &vb), 0, "Get failed");
    zassert_equal(vb.val.int_val, 2, "Status openProbe mismatch");
}
```

## src/test_snmp_traps.c
```c
/*
 * Copyright (c) 2026 DAECGE
 * SPDX-License-Identifier: Apache-2.0
 */

#include <zephyr/ztest.h>
#include <string.h>
#include <stdio.h>

#include <snmp/snmp.h>
#include <snmp/snmp_core.h>
#include <snmp/snmp_trap.h>

#include "infrastructure/adapters/adapter_snmp_traps.h"
#include "common/alarm_types.h"
#include "interfaces/i_alarm_query.h"

/* =========================================================================
 * Mock Alarm Query Implementation
 * ========================================================================= */

static alarm_bitmask_snapshot_t s_mock_bitmask;
static uint16_t s_mock_queried_id = 0;
static const char *s_mock_desc_text = "Test Alarm Description";

static size_t mock_get_active_count(void *impl)
{
    ARG_UNUSED(impl);
    return 1;
}

static alarm_severity_t mock_get_highest_severity(void *impl)
{
    ARG_UNUSED(impl);
    return ALARM_SEVERITY_CRITICAL;
}

static bool mock_is_active(void *impl, uint16_t id)
{
    ARG_UNUSED(impl);
    ARG_UNUSED(id);
    return true;
}

static int mock_get_alarm_state(void *impl, uint16_t id, alarm_state_t *out_state)
{
    ARG_UNUSED(impl);
    ARG_UNUSED(id);
    if (out_state != NULL) {
        *out_state = ALARM_STATE_ACTIVE;
    }
    return 0;
}

static int mock_get_alarm_snapshot(void *impl, uint16_t id, alarm_snapshot_entry_t *out_snap)
{
    ARG_UNUSED(impl);
    ARG_UNUSED(id);
    if (out_snap != NULL) {
        memset(out_snap, 0, sizeof(*out_snap));
        out_snap->alarm_id = id;
        out_snap->state = ALARM_STATE_ACTIVE;
    }
    return 0;
}

static size_t mock_get_active_alarm_ids(void *impl, uint16_t *out_ids, size_t max_count)
{
    ARG_UNUSED(impl);
    if (out_ids != NULL && max_count > 0) {
        out_ids[0] = s_mock_queried_id;
        return 1;
    }
    return 0;
}

static int mock_get_descriptor(void *impl, uint16_t id, alarm_descriptor_t *out_desc)
{
    ARG_UNUSED(impl);
    s_mock_queried_id = id;
    if (out_desc != NULL) {
        memset(out_desc, 0, sizeof(*out_desc));
        out_desc->alarm_id = id;
        out_desc->description = s_mock_desc_text;
        out_desc->default_severity = ALARM_SEVERITY_CRITICAL;
    }
    return 0;
}

static uint32_t mock_get_active_duration(void *impl, uint16_t id)
{
    ARG_UNUSED(impl);
    ARG_UNUSED(id);
    return 120;
}

static int mock_get_bitmask_snapshot(void *impl, alarm_bitmask_snapshot_t *out_snapshot)
{
    ARG_UNUSED(impl);
    if (out_snapshot != NULL) {
        *out_snapshot = s_mock_bitmask;
    }
    return 0;
}

static const i_alarm_query_api_t s_mock_alarm_query_api = {
    .get_active_count = mock_get_active_count,
    .get_highest_active_severity = mock_get_highest_severity,
    .is_active = mock_is_active,
    .get_alarm_state = mock_get_alarm_state,
    .get_alarm_snapshot = mock_get_alarm_snapshot,
    .get_active_alarm_ids = mock_get_active_alarm_ids,
    .get_descriptor = mock_get_descriptor,
    .get_active_duration = mock_get_active_duration,
    .get_bitmask_snapshot = mock_get_bitmask_snapshot,
};

static i_alarm_query_t make_mock_alarm_query(void)
{
    i_alarm_query_t port = {
        .api = &s_mock_alarm_query_api,
        .impl = (void *)0x1234,
    };
    return port;
}

/* =========================================================================
 * Test Suite Setup
 * ========================================================================= */

static struct snmp_agent s_agent;
static adapter_snmp_traps_t s_traps_ctx;

static void *snmp_traps_setup(void)
{
    int rc = snmp_agent_init(&s_agent, NULL);
    zassert_equal(rc, 0, "snmp_agent_init failed");
    return NULL;
}

static void snmp_traps_before(void *fixture)
{
    ARG_UNUSED(fixture);
    memset(&s_traps_ctx, 0, sizeof(s_traps_ctx));
    memset(&s_mock_bitmask, 0, sizeof(s_mock_bitmask));
    s_mock_queried_id = 0;
}

ZTEST_SUITE(snmp_traps_suite, NULL, snmp_traps_setup, snmp_traps_before, NULL, NULL);

/* =========================================================================
 * Test Cases
 * ========================================================================= */

ZTEST(snmp_traps_suite, test_adapter_init_validation)
{
    i_alarm_query_t query = make_mock_alarm_query();

    /* NULL context */
    int rc = adapter_snmp_traps_init(NULL, &s_agent, query);
    zassert_equal(rc, -EINVAL, "Must reject NULL context");

    /* NULL agent */
    rc = adapter_snmp_traps_init(&s_traps_ctx, NULL, query);
    zassert_equal(rc, -EINVAL, "Must reject NULL agent");

    /* Unbound query port is permitted (query methods are guarded by i_alarm_query_is_bound at runtime) */
    i_alarm_query_t unbound_query = { .api = NULL, .impl = NULL };
    rc = adapter_snmp_traps_init(&s_traps_ctx, &s_agent, unbound_query);
    zassert_equal(rc, 0, "Unbound query port must be accepted");

    /* Valid initialization */
    rc = adapter_snmp_traps_init(&s_traps_ctx, &s_agent, query);
    zassert_equal(rc, 0, "Initialization failed");
    zassert_true(s_traps_ctx.initialized, "Must be marked initialized");
    zassert_equal(s_traps_ctx.tokens, ADAPTER_SNMP_RATE_BURST_MAX, "Tokens must equal burst max");
    zassert_equal(s_traps_ctx.count, 0, "Queue must be empty");
    zassert_equal(s_traps_ctx.dropped_count, 0, "Dropped count must be 0");
}

ZTEST(snmp_traps_suite, test_post_event_and_drain)
{
    i_alarm_query_t query = make_mock_alarm_query();
    int rc = adapter_snmp_traps_init(&s_traps_ctx, &s_agent, query);
    zassert_equal(rc, 0, "Init failed");

    /* Post alarm triggered event */
    alarm_transition_event_t ev1 = {
        .alarm_id = ALARM_ID_GROUP1_TEMP_HIGH,
        .event_type = ALARM_EVENT_ACTIVATED,
        .timestamp_ms = 1234567,
    };

    rc = adapter_snmp_traps_post_event(&s_traps_ctx, &ev1);
    zassert_equal(rc, 0, "Post event 1 failed");

    /* Post alarm cleared event */
    alarm_transition_event_t ev2 = {
        .alarm_id = ALARM_ID_GROUP1_TEMP_HIGH,
        .event_type = ALARM_EVENT_CLEARED,
        .timestamp_ms = 1240000,
    };

    rc = adapter_snmp_traps_post_event(&s_traps_ctx, &ev2);
    zassert_equal(rc, 0, "Post event 2 failed");

    /* Wait for system workqueue to drain events */
    k_msleep(50);

    /* Queue should be fully drained */
    k_mutex_lock(&s_traps_ctx.lock, K_FOREVER);
    zassert_equal(s_traps_ctx.count, 0, "Queue must be empty after workqueue processing");
    zassert_equal(s_traps_ctx.dropped_count, 0, "No drops expected");
    k_mutex_unlock(&s_traps_ctx.lock);
}

ZTEST(snmp_traps_suite, test_queue_overflow_protection)
{
    i_alarm_query_t query = make_mock_alarm_query();
    int rc = adapter_snmp_traps_init(&s_traps_ctx, &s_agent, query);
    zassert_equal(rc, 0, "Init failed");

    /* Fill queue completely while holding lock to prevent workqueue from draining */
    k_mutex_lock(&s_traps_ctx.lock, K_FOREVER);

    for (uint32_t i = 0; i < ADAPTER_SNMP_TRAP_QUEUE_SIZE; i++) {
        alarm_transition_event_t ev = {
            .alarm_id = (uint16_t)(ALARM_ID_GROUP1_TEMP_HIGH + i),
            .event_type = ALARM_EVENT_ACTIVATED,
            .timestamp_ms = 1000 + i,
        };
        s_traps_ctx.queue[s_traps_ctx.tail] = ev;
        s_traps_ctx.tail = (uint8_t)((s_traps_ctx.tail + 1U) % ADAPTER_SNMP_TRAP_QUEUE_SIZE);
        s_traps_ctx.count++;
    }
    zassert_equal(s_traps_ctx.count, ADAPTER_SNMP_TRAP_QUEUE_SIZE, "Queue must be full");

    k_mutex_unlock(&s_traps_ctx.lock);

    /* Next post should succeed via drop-oldest policy, increment dropped_count, and set summary_pending */
    alarm_transition_event_t overflow_ev = {
        .alarm_id = 0x0099,
        .event_type = ALARM_EVENT_ACTIVATED,
        .timestamp_ms = 9999,
    };

    rc = adapter_snmp_traps_post_event(&s_traps_ctx, &overflow_ev);
    zassert_equal(rc, 0, "Post on full queue must succeed using drop-oldest policy");
    zassert_equal(s_traps_ctx.dropped_count, 1, "Dropped count must increment");
    zassert_true(s_traps_ctx.summary_pending, "Summary pending must be flagged");

    /* Allow workqueue to drain */
    k_msleep(50);
}

ZTEST(snmp_traps_suite, test_send_test_trap)
{
    i_alarm_query_t query = make_mock_alarm_query();
    int rc = adapter_snmp_traps_init(&s_traps_ctx, &s_agent, query);
    zassert_equal(rc, 0, "Init failed");

    /* Call test trap dispatch */
    rc = adapter_snmp_traps_send_test(&s_traps_ctx);
    zassert_equal(rc, 0, "adapter_snmp_traps_send_test must return 0");

    /* NULL context check */
    rc = adapter_snmp_traps_send_test(NULL);
    zassert_equal(rc, -EINVAL, "Must reject NULL context");
}
```
