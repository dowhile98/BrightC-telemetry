## CMakeLists.txt
```
# SPDX-License-Identifier: Apache-2.0
cmake_minimum_required(VERSION 3.20.0)
find_package(Zephyr REQUIRED HINTS $ENV{ZEPHYR_BASE})
project(unit_thermal_energy_test)

set(APP_DIR ${CMAKE_CURRENT_SOURCE_DIR}/../../..)

target_sources(app PRIVATE
    src/test_humidity_transducer.c
    src/test_psychrometrics.c
    src/test_thermodynamics.c
    src/test_compressor_fsm.c
    src/test_predictive_ols.c
    src/test_thermal_energy_port.c
    src/test_sensor_matrix_mapper.c
    src/test_ao_thermal_energy.c
    ${APP_DIR}/tests/fakes/src/fake_thermal_energy.c
    ${APP_DIR}/app/src/domain/thermal_energy/humidity_transducer.c
    ${APP_DIR}/app/src/domain/thermal_energy/psychrometrics.c
    ${APP_DIR}/app/src/domain/thermal_energy/thermodynamics.c
    ${APP_DIR}/app/src/domain/thermal_energy/compressor_fsm.c
    ${APP_DIR}/app/src/domain/thermal_energy/predictive_analytics.c
    ${APP_DIR}/app/src/infrastructure/adapters/sensor_matrix_mapper.c
    ${APP_DIR}/app/src/application/zbus/thermal_channels.c
    ${APP_DIR}/app/src/application/zbus/sensor_channels.c
    ${APP_DIR}/app/src/application/zbus/digital_input_channels.c
    ${APP_DIR}/app/src/application/active_objects/ao_thermal_energy.c
    ${APP_DIR}/app/src/application/config/default_config_profiles.c
)

target_include_directories(app PRIVATE
    ${APP_DIR}/app/include
    ${APP_DIR}/app/src
    ${APP_DIR}/tests/fakes/include
)
```

## prj.conf
```kconfig
# SPDX-License-Identifier: Apache-2.0
CONFIG_ZTEST=y
CONFIG_ASSERT=y
CONFIG_ZBUS=y
```

## src/test_ao_thermal_energy.c
```c
/*
 * Copyright (c) 2026 DAECGE
 * SPDX-License-Identifier: Apache-2.0
 *
 * @file test_ao_thermal_energy.c
 * @brief Unit tests for Active Object ao_thermal_energy, 720h circular buffer,
 *        and Zbus publication (Phase 5).
 */

#include <zephyr/ztest.h>
#include <zephyr/kernel.h>
#include <errno.h>
#include <string.h>

#include "application/active_objects/ao_thermal_energy.h"
#include "application/zbus/thermal_channels.h"
#include "common/app_defaults.h"

static K_THREAD_STACK_DEFINE(s_test_ao_stack, AO_THERMAL_ENERGY_STACK_SIZE);
static ao_thermal_energy_t s_test_ao;
static config_thermal_site_t s_test_site_cfg;
static config_thermal_baseline_t s_test_baseline_cfg;

/* Dummy listener callbacks satisfying Zbus observer dependencies for unit tests */
static void dummy_zbus_cb(const struct zbus_channel *chan) { ARG_UNUSED(chan); }
ZBUS_LISTENER_DEFINE(lis_hvac_sensor_feed, dummy_zbus_cb);
ZBUS_LISTENER_DEFINE(lis_alarm_sensor_feed, dummy_zbus_cb);
ZBUS_LISTENER_DEFINE(lis_hvac_di_feed, dummy_zbus_cb);
ZBUS_LISTENER_DEFINE(lis_alarm_di_feed, dummy_zbus_cb);

static void ao_thermal_energy_suite_before(void *fixture)
{
    ARG_UNUSED(fixture);
    memset(&s_test_ao, 0, sizeof(s_test_ao));
    memcpy(&s_test_site_cfg, app_defaults_get_thermal_site_cfg(), sizeof(s_test_site_cfg));
    memcpy(&s_test_baseline_cfg, app_defaults_get_thermal_baseline_cfg(), sizeof(s_test_baseline_cfg));
}

static void ao_thermal_energy_suite_after(void *fixture)
{
    ARG_UNUSED(fixture);
    if (s_test_ao.is_initialized) {
        (void)ao_thermal_energy_stop(&s_test_ao);
        (void)ao_thermal_energy_wait_stopped(&s_test_ao, K_MSEC(500));
        (void)ao_thermal_energy_deinit(&s_test_ao);
    }
}

ZTEST_SUITE(ao_thermal_energy_suite, NULL, NULL,
            ao_thermal_energy_suite_before, ao_thermal_energy_suite_after, NULL);

/* ========================================================================= */
/* Test Case 1: Canonical 5-Phase Lifecycle                                  */
/* ========================================================================= */

ZTEST(ao_thermal_energy_suite, test_canonical_5phase_lifecycle)
{
    /* Phase 1: Init */
    int ret = ao_thermal_energy_init(&s_test_ao,
                                     &s_test_site_cfg,
                                     &s_test_baseline_cfg,
                                     HVAC_MODE_TELEMETRY_ONLY,
                                     s_test_ao_stack,
                                     K_THREAD_STACK_SIZEOF(s_test_ao_stack),
                                     AO_THERMAL_ENERGY_PRIORITY);
    zassert_equal(ret, 0, "ao_thermal_energy_init must succeed");
    zassert_true(s_test_ao.is_initialized, "Must be marked initialized");
    zassert_false(s_test_ao.is_running, "Must not be running after init");

    /* Port must be bound */
    i_thermal_energy_t port = ao_thermal_energy_get_port(&s_test_ao);
    zassert_true(i_thermal_energy_is_bound(&port), "Port must be bound upon init");

    /* Duplicate start check without running */
    ret = ao_thermal_energy_stop(&s_test_ao);
    zassert_equal(ret, -EALREADY, "Stop when not running must return -EALREADY");

    /* Phase 2: Start */
    ret = ao_thermal_energy_start(&s_test_ao);
    zassert_equal(ret, 0, "ao_thermal_energy_start must succeed");
    zassert_true(s_test_ao.is_running, "Must be running after start");

    /* Duplicate start */
    ret = ao_thermal_energy_start(&s_test_ao);
    zassert_equal(ret, -EALREADY, "Duplicate start must return -EALREADY");

    /* Allow the worker thread to execute at least 1-2 cycles */
    k_sleep(K_MSEC(1200));

    /* Verify generations advance */
    thermal_energy_result_t res;
    ret = i_thermal_energy_get_latest_result(&port, &res);
    zassert_equal(ret, 0, "get_latest_result must succeed");
    zassert_true(res.generation_id > 0U, "Generation ID must advance (> 0)");

    /* Phase 3: Stop */
    ret = ao_thermal_energy_stop(&s_test_ao);
    zassert_equal(ret, 0, "ao_thermal_energy_stop must succeed");

    /* Phase 4: Wait Stopped */
    ret = ao_thermal_energy_wait_stopped(&s_test_ao, K_MSEC(AO_THERMAL_ENERGY_STOP_WAIT_MS));
    zassert_equal(ret, 0, "wait_stopped must return 0");
    zassert_false(s_test_ao.is_running, "Must not be running after wait_stopped");

    /* Phase 5: Deinit */
    ret = ao_thermal_energy_deinit(&s_test_ao);
    zassert_equal(ret, 0, "ao_thermal_energy_deinit must succeed");
    zassert_false(s_test_ao.is_initialized, "Must be uninitialized after deinit");
}

/* ========================================================================= */
/* Test Case 2: Atomic Queries via i_thermal_energy Port                     */
/* ========================================================================= */

ZTEST(ao_thermal_energy_suite, test_port_atomic_queries)
{
    int ret = ao_thermal_energy_init(&s_test_ao,
                                     &s_test_site_cfg,
                                     &s_test_baseline_cfg,
                                     HVAC_MODE_TELEMETRY_ONLY,
                                     s_test_ao_stack,
                                     K_THREAD_STACK_SIZEOF(s_test_ao_stack),
                                     AO_THERMAL_ENERGY_PRIORITY);
    zassert_equal(ret, 0);

    i_thermal_energy_t port = ao_thermal_energy_get_port(&s_test_ao);

    /* Ingest test electrical reading & feed sensor snapshot */
    energy_reading_t elec = {0};
    elec.total_active_power_kw = 12.0f; /* 12 kW */
    elec.is_valid = true;
    elec.timestamp_us = (uint64_t)k_ticks_to_us_near64(k_uptime_ticks());
    ao_thermal_energy_feed_energy_reading(&s_test_ao, &elec);

    sensor_snapshot_msg_t s_snap = {0};
    /* Pilot config uses pair 0: supply 10, ret 11 */
    s_snap.temperatures[9] = 14.0f;  /* supply flat ID 10 */
    s_snap.temperatures[10] = 24.0f; /* return flat ID 11 */
    s_snap.temperatures[49] = 12.0f; /* 4-20mA humidity ID 50: 12mA -> 50% RH */
    s_snap.valid_mask = (1ULL << 9) | (1ULL << 10) | (1ULL << 49);
    s_snap.timestamp_ms = (uint64_t)k_uptime_get();
    ao_thermal_energy_feed_sensor_snapshot(&s_test_ao, &s_snap);

    /* Step calculation manually */
    ret = ao_thermal_energy_step(&s_test_ao);
    zassert_equal(ret, 0, "ao_thermal_energy_step must succeed");

    /* Query latest result */
    thermal_energy_result_t res;
    ret = i_thermal_energy_get_latest_result(&port, &res);
    zassert_equal(ret, 0);
    zassert_true(res.generation_id > 0U);
    zassert_within(res.delta_t_pair[0], 10.0f, 0.1f, "Delta T must be ~10 C");

    /* Query latest capture */
    thermal_energy_capture_t cap;
    ret = i_thermal_energy_get_latest_capture(&port, &cap);
    zassert_equal(ret, 0);
    zassert_within(cap.t_inj[0], 14.0f, 0.01f);
    zassert_within(cap.t_ret[0], 24.0f, 0.01f);
    zassert_within(cap.total_active_power_kw, 12.0f, 0.01f);

    /* Query baseline */
    config_thermal_baseline_t base;
    ret = i_thermal_energy_get_baseline(&port, &base);
    zassert_equal(ret, 0);

    /* Recalibration trigger */
    ret = i_thermal_energy_trigger_baseline_recalibration(&port);
    zassert_equal(ret, 0);
    ret = i_thermal_energy_get_baseline(&port, &base);
    zassert_equal(ret, 0);
    zassert_equal(base.is_valid, 0U, "Baseline is_valid must be 0 after recalibration");
    zassert_equal(base.training_hours_accumulated, 0U, "Training hours must be 0 after recalibration");
}

/* ========================================================================= */
/* Test Case 3: Circular Buffer 720h RAM History                             */
/* ========================================================================= */

ZTEST(ao_thermal_energy_suite, test_circular_buffer_720h)
{
    int ret = ao_thermal_energy_init(&s_test_ao,
                                     &s_test_site_cfg,
                                     &s_test_baseline_cfg,
                                     HVAC_MODE_TELEMETRY_ONLY,
                                     s_test_ao_stack,
                                     K_THREAD_STACK_SIZEOF(s_test_ao_stack),
                                     AO_THERMAL_ENERGY_PRIORITY);
    zassert_equal(ret, 0);

    i_thermal_energy_t port = ao_thermal_energy_get_port(&s_test_ao);

    /* When empty, get_hourly_history must return -ENOENT */
    thermal_hourly_record_t rec;
    ret = i_thermal_energy_get_hourly_history(&port, 0, &rec);
    zassert_equal(ret, -ENOENT, "Empty history must return -ENOENT");

    /* Perform a step and force hourly compression for 5 consecutive hours */
    for (uint32_t h = 0; h < 5; h++) {
        (void)ao_thermal_energy_step(&s_test_ao);
        ret = ao_thermal_energy_record_hour(&s_test_ao);
        zassert_equal(ret, 0, "Hourly record must succeed");
    }

    zassert_equal(s_test_ao.history_count, 5U, "History count must be 5");

    /* hours_ago = 0 (most recent closed hour) */
    ret = i_thermal_energy_get_hourly_history(&port, 0, &rec);
    zassert_equal(ret, 0);
    zassert_true(rec.crc16 != 0U, "CRC16 must be populated");

    /* hours_ago = 4 (oldest of the 5) */
    ret = i_thermal_energy_get_hourly_history(&port, 4, &rec);
    zassert_equal(ret, 0);

    /* hours_ago = 5 (beyond count) -> -ENOENT */
    ret = i_thermal_energy_get_hourly_history(&port, 5, &rec);
    zassert_equal(ret, -ENOENT, "Offset beyond count must return -ENOENT");

    /* Test 720 wrap-around */
    for (uint32_t h = 5; h < 730; h++) {
        (void)ao_thermal_energy_record_hour(&s_test_ao);
    }
    zassert_equal(s_test_ao.history_count, THERMAL_HOURLY_HISTORY_CAPACITY,
                  "History count must be clamped at 720");

    /* Can query up to 719 hours ago */
    ret = i_thermal_energy_get_hourly_history(&port, 719, &rec);
    zassert_equal(ret, 0, "Offset 719 must succeed");

    /* Offset 720 -> -ENOENT */
    ret = i_thermal_energy_get_hourly_history(&port, 720, &rec);
    zassert_equal(ret, -ENOENT, "Offset 720 must return -ENOENT");
}

/* ========================================================================= */
/* Test Case 4: Zbus Event Notification                                      */
/* ========================================================================= */

ZTEST(ao_thermal_energy_suite, test_zbus_event_publication)
{
    int ret = ao_thermal_energy_init(&s_test_ao,
                                     &s_test_site_cfg,
                                     &s_test_baseline_cfg,
                                     HVAC_MODE_TELEMETRY_ONLY,
                                     s_test_ao_stack,
                                     K_THREAD_STACK_SIZEOF(s_test_ao_stack),
                                     AO_THERMAL_ENERGY_PRIORITY);
    zassert_equal(ret, 0);

    /* Perform a step */
    ret = ao_thermal_energy_step(&s_test_ao);
    zassert_equal(ret, 0);

    /* Read Zbus channel directly */
    thermal_energy_event_t evt = {0};
    ret = zbus_chan_read(&chan_thermal_energy_update, &evt, K_MSEC(100));
    zassert_equal(ret, 0, "zbus_chan_read must succeed");
    zassert_true(evt.generation_id > 0U, "Generation ID in event must be > 0");
    zassert_true(evt.timestamp_ms > 0ULL, "Timestamp in event must be > 0");
}

/* ========================================================================= */
/* Test Case 5: Mode Switching Propagates to Capture Mapping                 */
/* ========================================================================= */

ZTEST(ao_thermal_energy_suite, test_mode_switching_propagates_to_capture)
{
    /* Initialize in TELEMETRY_ONLY mode */
    int ret = ao_thermal_energy_init(&s_test_ao,
                                     &s_test_site_cfg,
                                     &s_test_baseline_cfg,
                                     HVAC_MODE_TELEMETRY_ONLY,
                                     s_test_ao_stack,
                                     K_THREAD_STACK_SIZEOF(s_test_ao_stack),
                                     AO_THERMAL_ENERGY_PRIORITY);
    zassert_equal(ret, 0);

    /* In TELEMETRY_ONLY mode, pin 0 of DI snapshot maps to Compressor 0 */
    di_snapshot_msg_t di_snap = {0};
    di_snap.active_mask = (1ULL << 0); /* Channel 0 active */
    di_snap.timestamp_ms = (uint64_t)k_uptime_get();
    ret = ao_thermal_energy_feed_di_snapshot(&s_test_ao, &di_snap);
    zassert_equal(ret, 0);

    ret = ao_thermal_energy_step(&s_test_ao);
    zassert_equal(ret, 0);

    /* Compressor 0 state mask must be set (bit 0 = 1) */
    zassert_true((s_test_ao.latest_capture.comp_state_mask & (1U << 0)) != 0U,
                 "In TELEMETRY_ONLY, pin 0 must map to compressor 0");

    /* Switch mode to HYBRID_FULL at runtime */
    ao_thermal_energy_set_hvac_mode(&s_test_ao, HVAC_MODE_HYBRID_FULL);

    ret = ao_thermal_energy_step(&s_test_ao);
    zassert_equal(ret, 0);

    /* In HYBRID_FULL mode, local pin 0 is an alarm cutout, NOT compressor feedback.
     * Therefore comp_state_mask bit 0 must be 0! */
    zassert_false((s_test_ao.latest_capture.comp_state_mask & (1U << 0)) != 0U,
                  "In HYBRID_FULL, local pin 0 must not map to compressor 0");
}

/* ========================================================================= */
/* Test Case 6: Filter Slope Calculation from 24h History                    */
/* ========================================================================= */

ZTEST(ao_thermal_energy_suite, test_filter_slope_from_24h_history)
{
    /* Initialize with baseline trained (training_hours >= 168) */
    s_test_baseline_cfg.training_hours_accumulated = 168U;
    s_test_baseline_cfg.is_valid = 1U;
    s_test_baseline_cfg.baseline_pair_t_inj[0] = 14.0f;
    s_test_baseline_cfg.baseline_pair_delta_t[0] = 10.0f;

    int ret = ao_thermal_energy_init(&s_test_ao,
                                     &s_test_site_cfg,
                                     &s_test_baseline_cfg,
                                     HVAC_MODE_TELEMETRY_ONLY,
                                     s_test_ao_stack,
                                     K_THREAD_STACK_SIZEOF(s_test_ao_stack),
                                     AO_THERMAL_ENERGY_PRIORITY);
    zassert_equal(ret, 0);

    /* Populate 25 hours of history where 24h ago t_inj was 14.0 C */
    for (uint32_t h = 0; h < 25; h++) {
        thermal_hourly_record_t rec;
        memset(&rec, 0, sizeof(rec));
        rec.t_inj_x10[0] = 140; /* 14.0 C */
        rec.t_ret_x10[0] = 240; /* 24.0 C */
        s_test_ao.history[s_test_ao.history_head] = rec;
        s_test_ao.history_head = (s_test_ao.history_head + 1U) % THERMAL_HOURLY_HISTORY_CAPACITY;
        if (s_test_ao.history_count < THERMAL_HOURLY_HISTORY_CAPACITY) {
            s_test_ao.history_count++;
        }
    }

    /* Provide a sensor snapshot where current t_inj = 12.0 C.
     * Slope = 12.0 - 14.0 = -2.0 C / day (active degradation).
     * Supply temp = 12.0 C, delta T = 24.0 - 12.0 = 12.0 C.
     * Filter restriction pct > 15%, so active degradation applies:
     * temp_diff = 12.0 - 7.5 = 4.5.
     * days = 4.5 / 2.0 = 2.25 -> ~2 days. */
    sensor_snapshot_msg_t snap = {0};
    snap.temperatures[9] = 12.0f;  /* pair 0 supply */
    snap.temperatures[10] = 24.0f; /* pair 0 return */
    snap.temperatures[49] = 12.0f; /* humidity */
    snap.valid_mask = (1ULL << 9) | (1ULL << 10) | (1ULL << 49);
    snap.timestamp_ms = (uint64_t)k_uptime_get();
    ret = ao_thermal_energy_feed_sensor_snapshot(&s_test_ao, &snap);
    zassert_equal(ret, 0);

    ret = ao_thermal_energy_step(&s_test_ao);
    zassert_equal(ret, 0);

    /* Verify days remaining reflects active slope degradation, not default 90 days */
    zassert_true(s_test_ao.latest_result.filter_days_remaining[0] < 90U,
                 "Days remaining (%u) must be < 90 when negative degradation slope is detected",
                 (unsigned int)s_test_ao.latest_result.filter_days_remaining[0]);
    zassert_within(s_test_ao.latest_result.filter_days_remaining[0], 2, 1,
                   "Days remaining should be ~2 days");
}

/* ========================================================================= */
/* Test Case 7: Stale Telemetry Degradation                                  */
/* ========================================================================= */

ZTEST(ao_thermal_energy_suite, test_stale_telemetry_degradation)
{
    int ret = ao_thermal_energy_init(&s_test_ao,
                                     &s_test_site_cfg,
                                     &s_test_baseline_cfg,
                                     HVAC_MODE_TELEMETRY_ONLY,
                                     s_test_ao_stack,
                                     K_THREAD_STACK_SIZEOF(s_test_ao_stack),
                                     AO_THERMAL_ENERGY_PRIORITY);
    zassert_equal(ret, 0);

    /* 1. Feed initial fresh readings */
    uint64_t now = (uint64_t)k_uptime_get();
    sensor_snapshot_msg_t snap = {0};
    snap.temperatures[9] = 14.0f;
    snap.temperatures[10] = 24.0f;
    snap.temperatures[49] = 12.0f;
    snap.valid_mask = (1ULL << 9) | (1ULL << 10) | (1ULL << 49);
    snap.timestamp_ms = now;
    ao_thermal_energy_feed_sensor_snapshot(&s_test_ao, &snap);

    energy_reading_t elec = {0};
    elec.total_active_power_kw = 10.0f;
    elec.is_valid = true;
    elec.timestamp_us = (uint64_t)k_ticks_to_us_near64(k_uptime_ticks());
    ao_thermal_energy_feed_energy_reading(&s_test_ao, &elec);

    /* Step: verify fresh telemetry is VALID */
    ret = ao_thermal_energy_step(&s_test_ao);
    zassert_equal(ret, 0);
    zassert_equal(s_test_ao.latest_result.thermal_quality, QUALITY_VALID);
    zassert_equal(s_test_ao.latest_result.cop_quality, QUALITY_VALID);
    zassert_equal(s_test_ao.latest_result.overall_quality, QUALITY_VALID);

    /* 2. Advance simulated time by 2100 ms without updating sensor snapshot */
    k_sleep(K_MSEC(2100));

    /* Refresh electrical reading so only temperature is stale */
    elec.timestamp_us = (uint64_t)k_ticks_to_us_near64(k_uptime_ticks());
    ao_thermal_energy_feed_energy_reading(&s_test_ao, &elec);

    ret = ao_thermal_energy_step(&s_test_ao);
    zassert_equal(ret, 0);

    /* Must degrade thermal_quality and overall_quality to QUALITY_SUSPECT */
    zassert_equal(s_test_ao.latest_result.thermal_quality, QUALITY_SUSPECT,
                  "Thermal quality must degrade to SUSPECT when sensor snapshot is > 2000 ms old");
    zassert_equal(s_test_ao.latest_result.overall_quality, QUALITY_SUSPECT,
                  "Overall quality must be SUSPECT when thermal telemetry is stale");

    /* 3. Refresh sensor snapshot, but advance time by 3100 ms without updating electrical */
    snap.timestamp_ms = (uint64_t)k_uptime_get();
    ao_thermal_energy_feed_sensor_snapshot(&s_test_ao, &snap);

    k_sleep(K_MSEC(3100));

    /* Keep sensor snapshot fresh */
    snap.timestamp_ms = (uint64_t)k_uptime_get();
    ao_thermal_energy_feed_sensor_snapshot(&s_test_ao, &snap);

    ret = ao_thermal_energy_step(&s_test_ao);
    zassert_equal(ret, 0);

    zassert_equal(s_test_ao.latest_result.thermal_quality, QUALITY_VALID,
                  "Thermal quality must be VALID when sensor snapshot is fresh");
    zassert_equal(s_test_ao.latest_result.cop_quality, QUALITY_SUSPECT,
                  "COP quality must degrade to SUSPECT when electrical reading is > 3000 ms old");
    zassert_equal(s_test_ao.latest_result.overall_quality, QUALITY_SUSPECT,
                  "Overall quality must be SUSPECT when COP is suspect");
}

/* ========================================================================= */
/* Test Case 8: Integrated Hourly Accumulators in OLS                        */
/* ========================================================================= */

ZTEST(ao_thermal_energy_suite, test_integrated_hourly_averages_in_ols)
{
    int ret = ao_thermal_energy_init(&s_test_ao,
                                     &s_test_site_cfg,
                                     &s_test_baseline_cfg,
                                     HVAC_MODE_TELEMETRY_ONLY,
                                     s_test_ao_stack,
                                     K_THREAD_STACK_SIZEOF(s_test_ao_stack),
                                     AO_THERMAL_ENERGY_PRIORITY);
    zassert_equal(ret, 0);

    /* Compressor 0 running */
    di_snapshot_msg_t di_snap = {0};
    di_snap.active_mask = (1ULL << 0);
    di_snap.timestamp_ms = (uint64_t)k_uptime_get();
    ao_thermal_energy_feed_di_snapshot(&s_test_ao, &di_snap);

    energy_reading_t elec = {0};
    elec.total_active_power_kw = 10.0f;
    elec.is_valid = true;
    elec.timestamp_us = (uint64_t)k_ticks_to_us_near64(k_uptime_ticks());
    ao_thermal_energy_feed_energy_reading(&s_test_ao, &elec);

    /* Step 1: Return temp 24 C, outdoor 30 C (outdoor probe table: 22, 23 -> flat IDs 22, 23 -> indices 21, 22) */
    sensor_snapshot_msg_t snap1 = {0};
    snap1.temperatures[9] = 14.0f;
    snap1.temperatures[10] = 24.0f;
    snap1.temperatures[21] = 30.0f;
    snap1.temperatures[22] = 30.0f;
    snap1.temperatures[49] = 12.0f;
    snap1.valid_mask = (1ULL << 9) | (1ULL << 10) | (1ULL << 21) | (1ULL << 22) | (1ULL << 49);
    snap1.timestamp_ms = (uint64_t)k_uptime_get();
    ao_thermal_energy_feed_sensor_snapshot(&s_test_ao, &snap1);
    ret = ao_thermal_energy_step(&s_test_ao);
    zassert_equal(ret, 0);

    /* Step 2: Return temp 26 C, outdoor 34 C */
    sensor_snapshot_msg_t snap2 = {0};
    snap2.temperatures[9] = 14.0f;
    snap2.temperatures[10] = 26.0f;
    snap2.temperatures[21] = 34.0f;
    snap2.temperatures[22] = 34.0f;
    snap2.temperatures[49] = 12.0f;
    snap2.valid_mask = (1ULL << 9) | (1ULL << 10) | (1ULL << 21) | (1ULL << 22) | (1ULL << 49);
    snap2.timestamp_ms = (uint64_t)k_uptime_get();
    ao_thermal_energy_feed_sensor_snapshot(&s_test_ao, &snap2);
    ret = ao_thermal_energy_step(&s_test_ao);
    zassert_equal(ret, 0);

    /* Accumulated 2 samples */
    zassert_equal(s_test_ao.hourly_samples_count, 2U, "Must have accumulated 2 samples");
    zassert_within((float)(s_test_ao.hourly_accum_t_ret / 2.0), 25.0f, 0.1f, "Integrated t_ret must be 25 C");
    zassert_within((float)(s_test_ao.hourly_accum_t_ext / 2.0), 32.0f, 0.1f, "Integrated t_ext must be 32 C");

    /* Force steady-state on compressor 0 to allow OLS accumulation */
    s_test_ao.comp_fsm[0].state = COMPRESSOR_STATE_STEADY_STATE;

    /* Call record hour */
    ret = ao_thermal_energy_record_hour(&s_test_ao);
    zassert_equal(ret, 0);

    /* Hourly accumulators must have been reset to zero for next hour */
    zassert_equal(s_test_ao.hourly_samples_count, 0U, "Hourly sample count must reset to 0");
    zassert_equal((uint32_t)s_test_ao.hourly_accum_t_ret, 0U, "Hourly accumulator must reset to 0");
    zassert_equal((uint32_t)s_test_ao.hourly_accum_t_ext, 0U, "Hourly accumulator must reset to 0");

    /* OLS must have accumulated 1 training hour */
    zassert_equal(s_test_ao.ols_model.training_hours, 1U, "OLS model must have accumulated 1 training hour");
}
```

## src/test_compressor_fsm.c
```c
/*
 * Copyright (c) 2026 DAECGE
 * SPDX-License-Identifier: Apache-2.0
 *
 * @file test_compressor_fsm.c
 * @brief Unit tests for compressor stabilization 5-phase FSM and load fraction (Suite 5).
 */

#include <zephyr/ztest.h>

#include "domain/thermal_energy/compressor_fsm.h"

ZTEST_SUITE(compressor_fsm_suite, NULL, NULL, NULL, NULL, NULL);

ZTEST(compressor_fsm_suite, test_fsm_power_on_initialization)
{
    compressor_fsm_t fsm;
    compressor_fsm_init(&fsm);

    zassert_equal(fsm.state, COMPRESSOR_STATE_OFF, "Boot state must be COMPRESSOR_STATE_OFF");
    zassert_equal(fsm.t_off_s, 0U, "Initial t_off must be 0");
    zassert_equal(fsm.t_on_s, 0U, "Initial t_on must be 0");
    zassert_equal(fsm.starts_count, 0U, "Initial starts_count must be 0");
    zassert_equal(fsm.short_cycle_count, 0U, "Initial short_cycle_count must be 0");
    zassert_false(fsm.steady_state, "steady_state must be false initially");

    /* Accumulate stopped time */
    for (int i = 0; i < 50; i++) {
        compressor_fsm_update(&fsm, false, 5.0f, false);
    }

    zassert_equal(fsm.state, COMPRESSOR_STATE_OFF, "State must remain OFF while contact open");
    zassert_equal(fsm.t_off_s, 50U, "t_off must accumulate to 50s");
}

ZTEST(compressor_fsm_suite, test_fsm_short_cycle_increment)
{
    compressor_fsm_t fsm;
    compressor_fsm_init(&fsm);

    /* Simulate stopped for 90 seconds (< 180 s) */
    for (int i = 0; i < 90; i++) {
        compressor_fsm_update(&fsm, false, 5.0f, false);
    }
    zassert_equal(fsm.t_off_s, 90U, "Stopped for 90s");

    /* Contact asserts on run edge */
    compressor_fsm_update(&fsm, true, 5.0f, false);

    zassert_equal(fsm.short_cycle_count, 1U, "Short cycle count must increment (90s < 180s)");
    zassert_equal(fsm.starts_count, 1U, "Starts count must increment");
    zassert_equal(fsm.state, COMPRESSOR_STATE_INRUSH_WAIT, "State must transition to INRUSH_WAIT");
    zassert_within(fsm.p_pre_start_kw, 5.0f, 0.001f, "Pre-start power must be latched");
}

ZTEST(compressor_fsm_suite, test_fsm_no_short_cycle_when_long_stop)
{
    compressor_fsm_t fsm;
    compressor_fsm_init(&fsm);

    /* Simulate stopped for 200 seconds (>= 180 s) */
    for (int i = 0; i < 200; i++) {
        compressor_fsm_update(&fsm, false, 5.0f, false);
    }

    /* Contact asserts */
    compressor_fsm_update(&fsm, true, 5.0f, false);

    zassert_equal(fsm.short_cycle_count, 0U, "Short cycle count must NOT increment (200s >= 180s)");
    zassert_equal(fsm.starts_count, 1U, "Starts count must increment");
    zassert_equal(fsm.state, COMPRESSOR_STATE_INRUSH_WAIT, "State must transition to INRUSH_WAIT");
}

ZTEST(compressor_fsm_suite, test_fsm_inrush_suppression)
{
    compressor_fsm_t fsm;
    compressor_fsm_init(&fsm);

    /* Start compressor */
    compressor_fsm_update(&fsm, true, 4.0f, false);
    zassert_equal(fsm.state, COMPRESSOR_STATE_INRUSH_WAIT, "Must enter INRUSH_WAIT");

    /* Advance 14 seconds (t_on = 1 .. 14) */
    for (int i = 1; i <= 14; i++) {
        compressor_fsm_update(&fsm, true, 25.0f /* inrush spike */, false);
        zassert_equal(fsm.state, COMPRESSOR_STATE_INRUSH_WAIT,
                      "At t_on=%d, state must still be INRUSH_WAIT", i);
        zassert_equal(fsm.delta_p_quality, QUALITY_UNAVAILABLE,
                      "Power samples must be discarded during inrush");
        zassert_false(fsm.steady_state, "steady_state must be false during inrush");
    }
}

ZTEST(compressor_fsm_suite, test_fsm_step_load_capture_success)
{
    compressor_fsm_t fsm;
    compressor_fsm_init(&fsm);

    /* Pre-start baseline power = 4.0 kW */
    compressor_fsm_update(&fsm, true, 4.0f, false);

    /* Run through 14 seconds */
    for (int i = 1; i <= 14; i++) {
        compressor_fsm_update(&fsm, true, 18.0f, false);
    }

    /* 15th second: isolated step load capture with total_power = 16.5 kW */
    compressor_fsm_update(&fsm, true, 16.5f, false);

    zassert_equal(fsm.state, COMPRESSOR_STATE_STEP_LOAD_CAPTURE,
                  "At t_on=15s, state must be STEP_LOAD_CAPTURE");
    zassert_equal(fsm.delta_p_quality, QUALITY_VALID, "Delta P must be QUALITY_VALID");
    /* Delta P = 16.5 - 4.0 = 12.5 kW */
    zassert_within(fsm.delta_p_comp_kw, 12.5f, 0.001f, "Delta P must be 12.5 kW");

    /* Next second (t_on=16s) -> transitions to THERMAL_WARMUP */
    compressor_fsm_update(&fsm, true, 16.5f, false);
    zassert_equal(fsm.state, COMPRESSOR_STATE_THERMAL_WARMUP,
                  "State must transition to THERMAL_WARMUP at t_on=16s");
    zassert_false(fsm.steady_state, "steady_state must still be false during warmup");
}

ZTEST(compressor_fsm_suite, test_fsm_step_load_concurrency_lockout)
{
    compressor_fsm_t fsm;
    compressor_fsm_init(&fsm);

    compressor_fsm_update(&fsm, true, 4.0f, false);

    /* Advance to 9 seconds */
    for (int i = 1; i <= 9; i++) {
        compressor_fsm_update(&fsm, true, 18.0f, false);
    }

    /* At t_on = 10s, concurrent transition detected (another motor started) */
    compressor_fsm_update(&fsm, true, 28.0f, true);

    /* Advance to 14 seconds */
    for (int i = 11; i <= 14; i++) {
        compressor_fsm_update(&fsm, true, 28.0f, false);
    }

    /* 15th second: step load capture evaluates concurrency lockout */
    compressor_fsm_update(&fsm, true, 28.0f, false);

    zassert_equal(fsm.state, COMPRESSOR_STATE_STEP_LOAD_CAPTURE,
                  "State must be STEP_LOAD_CAPTURE at 15s");
    zassert_equal(fsm.delta_p_quality, QUALITY_UNAVAILABLE,
                  "Delta P must be marked QUALITY_UNAVAILABLE due to concurrent start");
    zassert_equal(fsm.delta_p_comp_kw, 0.0f, "Delta P must be 0.0 when unavailable");
}

ZTEST(compressor_fsm_suite, test_fsm_steady_state_entry)
{
    compressor_fsm_t fsm;
    compressor_fsm_init(&fsm);

    /* Start and advance past inrush (15s) */
    compressor_fsm_update(&fsm, true, 4.0f, false);
    for (int i = 1; i <= 15; i++) {
        compressor_fsm_update(&fsm, true, 14.0f, false);
    }
    zassert_equal(fsm.state, COMPRESSOR_STATE_STEP_LOAD_CAPTURE, "Step load capture at 15s");

    /* Advance through warmup (16 to 179s) */
    for (int i = 16; i < 180; i++) {
        compressor_fsm_update(&fsm, true, 14.0f, false);
        zassert_equal(fsm.state, COMPRESSOR_STATE_THERMAL_WARMUP,
                      "Must remain in THERMAL_WARMUP at t_on=%d", i);
        zassert_false(fsm.steady_state, "steady_state must be false");
    }

    /* 180th second: reaches steady state */
    compressor_fsm_update(&fsm, true, 14.0f, false);
    zassert_equal(fsm.state, COMPRESSOR_STATE_STEADY_STATE,
                  "State must transition to STEADY_STATE at t_on=180s");
    zassert_true(fsm.steady_state, "steady_state must be true");

    /* Stays in steady state */
    compressor_fsm_update(&fsm, true, 14.0f, false);
    zassert_equal(fsm.state, COMPRESSOR_STATE_STEADY_STATE, "Must stay in STEADY_STATE");
    zassert_true(fsm.steady_state, "steady_state must remain true");
}

ZTEST(compressor_fsm_suite, test_fsm_stop_edge_reset)
{
    compressor_fsm_t fsm;
    compressor_fsm_init(&fsm);

    /* Run to steady state */
    compressor_fsm_update(&fsm, true, 4.0f, false);
    for (int i = 1; i <= 180; i++) {
        compressor_fsm_update(&fsm, true, 14.0f, false);
    }
    zassert_equal(fsm.state, COMPRESSOR_STATE_STEADY_STATE, "In steady state");

    /* Stop edge */
    compressor_fsm_update(&fsm, false, 4.0f, false);
    zassert_equal(fsm.state, COMPRESSOR_STATE_OFF, "Must immediately transition to OFF");
    zassert_equal(fsm.t_off_s, 0U, "t_off_s must be reset to 0");
    zassert_equal(fsm.t_on_s, 0U, "t_on_s must be reset to 0");
    zassert_false(fsm.steady_state, "steady_state must be cleared");

    /* Stays off and accumulates t_off */
    compressor_fsm_update(&fsm, false, 4.0f, false);
    zassert_equal(fsm.state, COMPRESSOR_STATE_OFF, "Remains OFF");
    zassert_equal(fsm.t_off_s, 1U, "t_off accumulates");
}

ZTEST(compressor_fsm_suite, test_compressor_load_fraction)
{
    compressor_fsm_t fsms[4];
    for (int i = 0; i < 4; i++) {
        compressor_fsm_init(&fsms[i]);
    }

    float nominal_caps[4] = {10.0f, 10.0f, 20.0f, 20.0f}; /* Total 60 kW */

    /* All OFF */
    float f_load = compressor_fsm_calc_load_fraction(fsms, 4, nominal_caps);
    zassert_equal(f_load, 0.0f, "Load fraction must be 0 when all OFF");

    /* Turn ON compressor 0 (10 kW) and 2 (20 kW) -> 30 kW active / 60 kW total = 0.50 */
    compressor_fsm_update(&fsms[0], true, 10.0f, false);
    compressor_fsm_update(&fsms[2], true, 20.0f, false);

    f_load = compressor_fsm_calc_load_fraction(fsms, 4, nominal_caps);
    zassert_within(f_load, 0.50f, 0.001f, "Load fraction must be 30/60 = 0.50");

    /* Turn ON all 4 compressors -> 60 / 60 = 1.00 */
    compressor_fsm_update(&fsms[1], true, 10.0f, false);
    compressor_fsm_update(&fsms[3], true, 20.0f, false);

    f_load = compressor_fsm_calc_load_fraction(fsms, 4, nominal_caps);
    zassert_within(f_load, 1.00f, 0.001f, "Load fraction must be 60/60 = 1.00");

    /* Unweighted calculation (NULL nominal_capacities) */
    /* 4 active out of 4 -> 1.0 */
    f_load = compressor_fsm_calc_load_fraction(fsms, 4, NULL);
    zassert_within(f_load, 1.00f, 0.001f, "Unweighted 4/4 must be 1.00");

    /* Turn off 1 unit -> 3 active out of 4 -> 0.75 */
    compressor_fsm_update(&fsms[0], false, 0.0f, false);
    f_load = compressor_fsm_calc_load_fraction(fsms, 4, NULL);
    zassert_within(f_load, 0.75f, 0.001f, "Unweighted 3/4 must be 0.75");

    /* Defensive: NULL fsms or count = 0 */
    zassert_equal(compressor_fsm_calc_load_fraction(NULL, 4, nominal_caps), 0.0f,
                  "NULL fsms must return 0.0");
    zassert_equal(compressor_fsm_calc_load_fraction(fsms, 0, nominal_caps), 0.0f,
                  "Zero count must return 0.0");
}
```

## src/test_humidity_transducer.c
```c
/*
 * Copyright (c) 2026 DAECGE
 * SPDX-License-Identifier: Apache-2.0
 *
 * @file test_humidity_transducer.c
 * @brief Unit tests for 4-20 mA NAMUR NE43 Return Relative Humidity Transducer (Suite 2).
 */

#include <zephyr/ztest.h>
#include <math.h>

#include "domain/thermal_energy/humidity_transducer.h"

ZTEST_SUITE(humidity_transducer_suite, NULL, NULL, NULL, NULL, NULL);

ZTEST(humidity_transducer_suite, test_humidity_loop_break_fault)
{
    float rh = -1.0f;
    quality_status_t q = humidity_transducer_process(0.0f, &rh);

    zassert_equal(q, QUALITY_FAILED, "0.0 mA must be QUALITY_FAILED");
    zassert_within(rh, 0.0f, 0.001f, "HR_ret must be clamped to 0.0%%");
}

ZTEST(humidity_transducer_suite, test_humidity_loop_sub_minimum)
{
    float rh = -1.0f;
    quality_status_t q = humidity_transducer_process(3.2f, &rh);

    zassert_equal(q, QUALITY_FAILED, "3.2 mA must be QUALITY_FAILED (< 3.5 mA NAMUR)");
    zassert_within(rh, 0.0f, 0.001f, "HR_ret must be clamped to 0.0%%");
}

ZTEST(humidity_transducer_suite, test_humidity_lower_margin_clamp)
{
    float rh = -1.0f;
    quality_status_t q = humidity_transducer_process(3.7f, &rh);

    zassert_equal(q, QUALITY_SUSPECT, "3.7 mA must be QUALITY_SUSPECT (3.5 to 4.0 mA margin)");
    zassert_within(rh, 0.0f, 0.001f, "HR_ret must be clamped to 0.0%%");
}

ZTEST(humidity_transducer_suite, test_humidity_exact_zero_scale)
{
    float rh = -1.0f;
    quality_status_t q = humidity_transducer_process(4.0f, &rh);

    zassert_equal(q, QUALITY_VALID, "4.0 mA must be QUALITY_VALID");
    zassert_within(rh, 0.0f, 0.001f, "HR_ret must be 0.0%% at 4.0 mA");
}

ZTEST(humidity_transducer_suite, test_humidity_mid_scale_reading)
{
    float rh = -1.0f;
    quality_status_t q = humidity_transducer_process(12.0f, &rh);

    zassert_equal(q, QUALITY_VALID, "12.0 mA must be QUALITY_VALID");
    zassert_within(rh, 50.0f, 0.05f, "HR_ret must be 50.0%% at 12.0 mA");
}

ZTEST(humidity_transducer_suite, test_humidity_exact_full_scale)
{
    float rh = -1.0f;
    quality_status_t q = humidity_transducer_process(20.0f, &rh);

    zassert_equal(q, QUALITY_VALID, "20.0 mA must be QUALITY_VALID");
    zassert_within(rh, 100.0f, 0.05f, "HR_ret must be 100.0%% at 20.0 mA");
}

ZTEST(humidity_transducer_suite, test_humidity_upper_margin_clamp)
{
    float rh = -1.0f;
    quality_status_t q = humidity_transducer_process(20.5f, &rh);

    zassert_equal(q, QUALITY_SUSPECT, "20.5 mA must be QUALITY_SUSPECT (saturation margin)");
    zassert_within(rh, 100.0f, 0.001f, "HR_ret must be clamped to 100.0%%");
}

ZTEST(humidity_transducer_suite, test_humidity_over_current_fault)
{
    float rh = -1.0f;
    quality_status_t q = humidity_transducer_process(22.0f, &rh);

    zassert_equal(q, QUALITY_FAILED, "22.0 mA must be QUALITY_FAILED (> 20.5 mA overcurrent)");
    zassert_within(rh, 100.0f, 0.001f, "HR_ret must be clamped to 100.0%%");
}

ZTEST(humidity_transducer_suite, test_humidity_from_adc)
{
    /* 150 Ohm shunt with 3.3V full scale 16-bit ADC (65536 counts) */
    /* For 12.0 mA (mid scale -> 50% RH):
     * V = 0.012 A * 150 Ohm = 1.8 V
     * counts = 1.8 * (65536 / 3.3) = 35746.9 -> 35747 counts
     */
    uint16_t counts_mid = 35747U;
    float current_ma = 0.0f;
    float rh = 0.0f;

    quality_status_t q = humidity_transducer_from_adc(counts_mid, 150.0f, &current_ma, &rh);

    zassert_equal(q, QUALITY_VALID, "Mid-scale ADC conversion must be valid");
    zassert_within(current_ma, 12.0f, 0.05f, "Current should be approx 12.0 mA");
    zassert_within(rh, 50.0f, 0.3f, "RH should be approx 50.0%%");
}

ZTEST(humidity_transducer_suite, test_humidity_defensive_guards)
{
    /* NULL output pointer */
    zassert_equal(humidity_transducer_process(12.0f, NULL), QUALITY_FAILED,
                  "NULL out_rh_pct must return QUALITY_FAILED");

    /* NaN and Infinity */
    float rh = 0.0f;
    zassert_equal(humidity_transducer_process(NAN, &rh), QUALITY_FAILED,
                  "NaN must return QUALITY_FAILED");
    zassert_equal(humidity_transducer_process(INFINITY, &rh), QUALITY_FAILED,
                  "Inf must return QUALITY_FAILED");

    /* Invalid shunt resistance */
    float current_ma = 0.0f;
    zassert_equal(humidity_transducer_from_adc(1000, 0.0f, &current_ma, &rh), QUALITY_FAILED,
                  "Zero shunt resistance must return QUALITY_FAILED");
    zassert_equal(humidity_transducer_from_adc(1000, -50.0f, &current_ma, &rh), QUALITY_FAILED,
                  "Negative shunt resistance must return QUALITY_FAILED");
}
```

## src/test_psychrometrics.c
```c
/*
 * Copyright (c) 2026 DAECGE
 * SPDX-License-Identifier: Apache-2.0
 *
 * @file test_psychrometrics.c
 * @brief Unit tests for moist air psychrometrics, pressure and density (Suite 3).
 */

#include <zephyr/ztest.h>
#include <math.h>

#include "domain/thermal_energy/psychrometrics.h"

ZTEST_SUITE(psychrometrics_suite, NULL, NULL, NULL, NULL, NULL);

ZTEST(psychrometrics_suite, test_psychrometric_sea_level_nominal)
{
    /* Z = 0 m, T_ret = 24.0 deg C, HR_ret = 50.0 % */
    float p_atm = psychrometrics_p_atm(0);
    zassert_within(p_atm, 101.325f, 0.001f, "P_atm at sea level must be 101.325 kPa");

    float p_ws = psychrometrics_p_ws(24.0f);
    zassert_within(p_ws, 2.985f, 0.005f, "P_ws at 24C must be 2.985 kPa");

    float p_w = psychrometrics_p_w(p_ws, 50.0f);
    zassert_within(p_w, 1.493f, 0.005f, "P_w at 24C 50%% must be 1.493 kPa");

    float omega = psychrometrics_humidity_ratio(p_atm, p_w);
    zassert_within(omega, 0.00931f, 0.00005f, "omega at 24C 50%% must be 0.00931 kg/kg");

    float t_dew = psychrometrics_dew_point(p_w);
    zassert_within(t_dew, 12.93f, 0.05f, "T_dew at P_w=1.493 must be 12.93 deg C");

    float rho_da = psychrometrics_dry_air_density(p_atm, p_w, 24.0f);
    zassert_within(rho_da, 1.170f, 0.005f, "rho_da at 24C 50%% must be 1.170 kg/m3");
}

ZTEST(psychrometrics_suite, test_psychrometric_high_altitude_bogota)
{
    /* Z = 2600 m, T_ret = 22.0 deg C, HR_ret = 60.0 % */
    float p_atm = psychrometrics_p_atm(2600);
    zassert_within(p_atm, 73.75f, 0.40f, "P_atm at 2600 m must be ~73.75 kPa");

    float p_ws = psychrometrics_p_ws(22.0f);
    zassert_within(p_ws, 2.645f, 0.005f, "P_ws at 22C must be 2.645 kPa");

    float p_w = psychrometrics_p_w(p_ws, 60.0f);
    zassert_within(p_w, 1.587f, 0.005f, "P_w at 22C 60%% must be 1.587 kPa");

    float omega = psychrometrics_humidity_ratio(p_atm, p_w);
    zassert_within(omega, 0.01368f, 0.00010f, "omega at 2600m 22C 60%% must be ~0.01368 kg/kg");

    float rho_da = psychrometrics_dry_air_density(p_atm, p_w, 22.0f);
    zassert_within(rho_da, 0.854f, 0.005f, "rho_da at 2600m 22C must be 0.854 kg/m3");
}

ZTEST(psychrometrics_suite, test_psychrometric_ashrae_25c_50rh)
{
    /* Standard ASHRAE Fundamentals test point: 25.0 deg C, 50.0 % RH at sea level */
    float p_atm = psychrometrics_p_atm(0);
    float p_ws = psychrometrics_p_ws(25.0f);
    zassert_within(p_ws, 3.169f, 0.010f, "P_ws at 25C must be ~3.169 kPa");

    float p_w = psychrometrics_p_w(p_ws, 50.0f);
    zassert_within(p_w, 1.585f, 0.010f, "P_w at 25C 50%% must be ~1.585 kPa");

    float omega = psychrometrics_humidity_ratio(p_atm, p_w);
    zassert_within(omega, 0.00988f, 0.0001f, "omega at 25C 50%% must be ~0.00988 kg/kg");

    float t_dew = psychrometrics_dew_point(p_w);
    zassert_within(t_dew, 13.87f, 0.10f, "T_dew at 25C 50%% must be ~13.87 deg C");

    float rho_da = psychrometrics_dry_air_density(p_atm, p_w, 25.0f);
    zassert_within(rho_da, 1.165f, 0.005f, "rho_da at 25C 50%% must be ~1.165 kg/m3");
}

ZTEST(psychrometrics_suite, test_psychrometric_air_mass_flow)
{
    float nominal_airflow = 4500.0f; /* m3/h */
    float rho_da = 1.170f;           /* kg/m3 */

    /* Active fan */
    float m_dot_active = psychrometrics_air_mass_flow(nominal_airflow, rho_da, true);
    float expected = (4500.0f / 3600.0f) * 1.170f; /* 1.4625 kg/s */
    zassert_within(m_dot_active, expected, 0.0001f, "m_dot when fan active must be 1.4625 kg/s");

    /* Inactive fan -> must strictly return 0.0 kg/s (Decoupling Rule F-01) */
    float m_dot_inactive = psychrometrics_air_mass_flow(nominal_airflow, rho_da, false);
    zassert_equal(m_dot_inactive, 0.0f, "m_dot must be 0.0 kg/s when fan inactive");
}

ZTEST(psychrometrics_suite, test_psychrometric_defensive_bounds)
{
    /* Altitude clamping [-100, 4000] */
    float p_below = psychrometrics_p_atm(-500);
    float p_min_clamp = psychrometrics_p_atm(-100);
    zassert_equal(p_below, p_min_clamp, "Altitude below -100m must be clamped");

    float p_above = psychrometrics_p_atm(6000);
    float p_max_clamp = psychrometrics_p_atm(4000);
    zassert_equal(p_above, p_max_clamp, "Altitude above 4000m must be clamped");

    /* Negative / zero vapor pressure */
    zassert_equal(psychrometrics_humidity_ratio(101.325f, -1.0f), 0.0f,
                  "Negative P_w must return 0.0");
    zassert_equal(psychrometrics_dew_point(0.0f), -50.0f,
                  "Zero P_w must return safe -50C");

    /* Denominator limit: P_atm - P_w <= 1.0 kPa */
    zassert_equal(psychrometrics_humidity_ratio(100.0f, 99.5f), 0.0f,
                  "Denom <= 1.0 kPa must return 0.0");

    /* Extreme cold dew point */
    zassert_equal(psychrometrics_dew_point(0.0005f), -50.0f,
                  "P_w <= 0.001 kPa must return -50.0C");
}
```

## src/test_thermal_energy_port.c
```c
/*
 * Copyright (c) 2026 DAECGE
 * SPDX-License-Identifier: Apache-2.0
 *
 * @file test_thermal_energy_port.c
 * @brief Unit tests for i_thermal_energy port contract and fake double.
 */

#include <zephyr/ztest.h>
#include <errno.h>
#include <string.h>

#include "interfaces/i_thermal_energy.h"
#include "fake_thermal_energy.h"

static void thermal_energy_port_suite_before(void *fixture)
{
    ARG_UNUSED(fixture);
    fake_thermal_energy_reset();
}

ZTEST_SUITE(thermal_energy_port_suite, NULL, NULL, thermal_energy_port_suite_before, NULL, NULL);

ZTEST(thermal_energy_port_suite, test_port_unbound_and_null_checks)
{
    i_thermal_energy_t null_port = {0};
    thermal_energy_result_t res;
    thermal_energy_capture_t cap;
    thermal_hourly_record_t rec;
    config_thermal_baseline_t base;

    zassert_false(i_thermal_energy_is_bound(NULL), "NULL port must not be bound");
    zassert_false(i_thermal_energy_is_bound(&null_port), "Empty port must not be bound");

    /* Defensive calls on unbound port */
    zassert_equal(i_thermal_energy_get_latest_result(&null_port, &res), -EINVAL);
    zassert_equal(i_thermal_energy_get_latest_capture(&null_port, &cap), -EINVAL);
    zassert_equal(i_thermal_energy_get_hourly_history(&null_port, 0, &rec), -EINVAL);
    zassert_equal(i_thermal_energy_get_baseline(&null_port, &base), -EINVAL);
    zassert_equal(i_thermal_energy_trigger_baseline_recalibration(&null_port), -EINVAL);
}

ZTEST(thermal_energy_port_suite, test_port_bound_null_output_buffers)
{
    i_thermal_energy_t port = fake_thermal_energy_get_port();
    zassert_true(i_thermal_energy_is_bound(&port), "Fake port must be bound");

    zassert_equal(i_thermal_energy_get_latest_result(&port, NULL), -EINVAL);
    zassert_equal(i_thermal_energy_get_latest_capture(&port, NULL), -EINVAL);
    zassert_equal(i_thermal_energy_get_hourly_history(&port, 0, NULL), -EINVAL);
    zassert_equal(i_thermal_energy_get_baseline(&port, NULL), -EINVAL);
}

ZTEST(thermal_energy_port_suite, test_get_latest_result_roundtrip)
{
    i_thermal_energy_t port = fake_thermal_energy_get_port();
    thermal_energy_result_t mock_res = {0};
    mock_res.generation_id = 42U;
    mock_res.q_total = 28.5f;
    mock_res.cop_real = 3.65f;
    mock_res.overall_quality = QUALITY_VALID;

    fake_thermal_energy_set_latest_result(&mock_res);

    thermal_energy_result_t out_res = {0};
    int ret = i_thermal_energy_get_latest_result(&port, &out_res);

    zassert_equal(ret, 0, "get_latest_result must return 0");
    zassert_equal(out_res.generation_id, 42U);
    zassert_within(out_res.q_total, 28.5f, 0.001f);
    zassert_within(out_res.cop_real, 3.65f, 0.001f);
    zassert_equal(out_res.overall_quality, QUALITY_VALID);

    const fake_thermal_energy_state_t *st = fake_thermal_energy_get_state();
    zassert_equal(st->get_latest_result_calls, 1U);
}

ZTEST(thermal_energy_port_suite, test_get_latest_capture_roundtrip)
{
    i_thermal_energy_t port = fake_thermal_energy_get_port();
    thermal_energy_capture_t mock_cap = {0};
    mock_cap.generation_id = 101U;
    mock_cap.configured_pairs = 6U;
    mock_cap.t_inj[0] = 14.5f;
    mock_cap.t_ret[0] = 24.0f;
    mock_cap.humidity_return_pct = 48.0f;
    mock_cap.total_active_power_kw = 8.2f;

    fake_thermal_energy_set_latest_capture(&mock_cap);

    thermal_energy_capture_t out_cap = {0};
    int ret = i_thermal_energy_get_latest_capture(&port, &out_cap);

    zassert_equal(ret, 0, "get_latest_capture must return 0");
    zassert_equal(out_cap.generation_id, 101U);
    zassert_within(out_cap.t_inj[0], 14.5f, 0.001f);
    zassert_within(out_cap.t_ret[0], 24.0f, 0.001f);
    zassert_within(out_cap.humidity_return_pct, 48.0f, 0.001f);

    const fake_thermal_energy_state_t *st = fake_thermal_energy_get_state();
    zassert_equal(st->get_latest_capture_calls, 1U);
}

ZTEST(thermal_energy_port_suite, test_get_hourly_history_records)
{
    i_thermal_energy_t port = fake_thermal_energy_get_port();

    thermal_hourly_record_t mock_rec = {0};
    mock_rec.timestamp_unix = 1700000000U;
    mock_rec.active_power_kw = 7.5f;
    mock_rec.sensible_capacity_kw = 22.0f;

    fake_thermal_energy_set_hourly_record(0, &mock_rec);

    thermal_hourly_record_t out_rec = {0};
    int ret = i_thermal_energy_get_hourly_history(&port, 0, &out_rec);
    zassert_equal(ret, 0);
    zassert_equal(out_rec.timestamp_unix, 1700000000U);
    zassert_within(out_rec.active_power_kw, 7.5f, 0.001f);

    /* Unpopulated record must return -ENOENT */
    ret = i_thermal_energy_get_hourly_history(&port, 5, &out_rec);
    zassert_equal(ret, -ENOENT);

    /* Out of bounds hours_ago must return -ENOENT */
    ret = i_thermal_energy_get_hourly_history(&port, 100, &out_rec);
    zassert_equal(ret, -ENOENT);
}

ZTEST(thermal_energy_port_suite, test_baseline_and_recalibration)
{
    i_thermal_energy_t port = fake_thermal_energy_get_port();

    config_thermal_baseline_t mock_base = {0};
    mock_base.is_valid = 1U;
    mock_base.training_hours_accumulated = 168U;
    mock_base.baseline_exergetic_efficiency = 44.5f;

    fake_thermal_energy_set_baseline(&mock_base);

    config_thermal_baseline_t out_base = {0};
    int ret = i_thermal_energy_get_baseline(&port, &out_base);
    zassert_equal(ret, 0);
    zassert_equal(out_base.is_valid, 1U);
    zassert_equal(out_base.training_hours_accumulated, 168U);
    zassert_within(out_base.baseline_exergetic_efficiency, 44.5f, 0.001f);

    ret = i_thermal_energy_trigger_baseline_recalibration(&port);
    zassert_equal(ret, 0);

    const fake_thermal_energy_state_t *st = fake_thermal_energy_get_state();
    zassert_equal(st->trigger_recalibration_calls, 1U);
}

ZTEST(thermal_energy_port_suite, test_override_return_codes)
{
    i_thermal_energy_t port = fake_thermal_energy_get_port();
    thermal_energy_result_t res;

    fake_thermal_energy_set_latest_result_ret(-EBUSY);
    zassert_equal(i_thermal_energy_get_latest_result(&port, &res), -EBUSY);

    fake_thermal_energy_set_recalibration_ret(-EALREADY);
    zassert_equal(i_thermal_energy_trigger_baseline_recalibration(&port), -EALREADY);
}
```
