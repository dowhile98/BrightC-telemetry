## boards/daecge/brightc-controllerv3/Kconfig.brightc-controllerv3
```kconfig
# Copyright (c) 2026 DAECGE
# SPDX-License-Identifier: Apache-2.0

config BOARD_BRIGHTC_CONTROLLERV3
	select SOC_STM32H743XX
```

## boards/daecge/brightc-controllerv3/Kconfig.defconfig
```kconfig
# DAECGE BrightC Controller V3 configuration

# SPDX-License-Identifier: Apache-2.0

if BOARD_BRIGHTC_CONTROLLERV3

configdefault NET_L2_ETHERNET
	default y

endif # BOARD_BRIGHTC_CONTROLLERV3
```

## boards/daecge/brightc-controllerv3/board.yml
```yaml
board:
  name: brightc-controllerv3
  full_name: DAECGE BrightC Controller V3
  vendor: daecge
  socs:
    - name: stm32h743xx
```

## drivers/adc_dma/Kconfig
```kconfig
# Copyright (c) 2026 DAECGE
# SPDX-License-Identifier: Apache-2.0

config ADC_DMA_ENGINE
	bool "Multi-ADC DMA Parallel Engine for STM32H7"
	default y
	depends on ADC
	help
	  Enable the multi-ADC DMA parallel acquisition engine driver.
```

## dts/bindings/adc/daecge,adc-dma-engine.yaml
```yaml
description: DAECGE Multi-ADC DMA Parallel Acquisition Engine
compatible: "daecge,adc-dma-engine"

properties:
  io-channels:
    type: phandle-array
    required: true
    description: List of ADC channels to sample via DMA (e.g. <&adc1 10>, <&adc2 6>)
  resolution:
    type: int
    default: 16
    description: ADC sampling bit resolution (16-bit for STM32H7)
```

## lib/Kconfig
```kconfig
# Copyright (c) 2026 DAECGE
# SPDX-License-Identifier: Apache-2.0

menu "BrightC Libraries"

rsource "custom/Kconfig"

config BRIGHTC_LIB_FILTER
	bool "Digital Signal Filters (EMA, Median)"
	default y
	help
	  Enable pure C digital signal filtering library.

config BRIGHTC_LIB_TRANSDUCERS
	bool "Analog Transducer Formulas (RTD, 4-20mA, Voltage Divider, Linear)"
	default y
	help
	  Enable pure C analog transducer conversion and NAMUR NE43 library.

config BRIGHTC_LIB_MODBUS_CODEC
	bool "Modbus Register Codec"
	default y
	help
	  Enable pure C Modbus register decoding (float32, scaled integers).

endmenu
```

## tests/unit/alarm/testcase.yaml
```yaml
tests:
  unit.alarm:
    tags:
      - alarm
      - domain
      - unit
    platform_allow: native_sim
```

## tests/unit/datalogger/testcase.yaml
```yaml
tests:
  unit.datalogger:
    tags:
      - storage
      - datalogger
      - bkpsram
      - unit
    platform_allow: native_sim
```

## tests/unit/digital_input/testcase.yaml
```yaml
common:
  tags:
    - unit
    - digital_input
  platform_allow:
    - native_sim
    - qemu_cortex_m3
tests:
  unit.digital_input.all:
    integration_platforms:
      - native_sim
```

## tests/unit/hvac/testcase.yaml
```yaml
common:
  tags:
    - unit
    - hvac
  platform_allow:
    - native_sim
    - qemu_cortex_m3
tests:
  unit.hvac.all:
    integration_platforms:
      - native_sim
```

## tests/unit/indicators/testcase.yaml
```yaml
common:
  tags:
    - unit
    - indicators
  platform_allow:
    - native_sim
    - qemu_cortex_m3
tests:
  unit.indicators.all:
    integration_platforms:
      - native_sim
```

## tests/unit/modbus_tcp/testcase.yaml
```yaml
tests:
  unit.modbus_tcp:
    tags:
      - modbus_tcp
      - mapping
      - unit
    platform_allow: native_sim
```

## tests/unit/rtc/testcase.yaml
```yaml
tests:
  unit.rtc:
    tags:
      - rtc
      - domain
      - time
      - unit
    platform_allow: native_sim
```

## tests/unit/storage/testcase.yaml
```yaml
common:
  tags:
    - unit
    - storage
  platform_allow:
    - native_sim
    - qemu_cortex_m3
tests:
  unit.storage.all:
    integration_platforms:
      - native_sim
```

## tests/unit/storage_sd/testcase.yaml
```yaml
tests:
  unit.storage_sd:
    tags:
      - storage
      - sd
      - domain
      - unit
    platform_allow: native_sim
```

## tests/unit/thermal_energy/testcase.yaml
```yaml
tests:
  unit.thermal_energy:
    tags:
      - thermal_energy
      - domain
      - psychrometrics
      - unit
    platform_allow: native_sim
```

## west.yml
```yaml
# Copyright (c) 2021 Nordic Semiconductor ASA
# SPDX-License-Identifier: Apache-2.0

manifest:
  self:
    west-commands: scripts/west-commands.yml

  remotes:
    - name: zephyrproject-rtos
      url-base: https://github.com/zephyrproject-rtos

  projects:
    - name: zephyr
      remote: zephyrproject-rtos
      revision: main
      import:
        # By using name-allowlist we can clone only the modules that are
        # strictly needed by the application.
        name-allowlist:
          - cmsis_6    # required by the ARM port for Cortex-M
          - hal_nordic # required by the custom_plank board (Nordic based)
          - hal_stm32  # required by the nucleo_f302r8 board (STM32 based)
          - fatfs
          - mbedtls
          - mldsa-native
          - tf-psa-crypto
          - mipi-sys-t
          - percepio
          - segger
          - lvgl
          - zcbor
          - nanopb
          - cmsis-dsp
          - cmsis-nn
    - name: microconf
      url: https://github.com/dowhile98/microconf.git
      revision: master
      path: modules/lib/microconf
    - name: nanoMODBUS
      url: https://github.com/dowhile98/nanoMODBUS.git
      revision: master
      path: modules/lib/nanoMODBUS
    - name: zephyr-snmp
      url: https://github.com/dowhile98/zephyr-snmp.git
      revision: main
      path: modules/lib/zephyr-snmp
```
